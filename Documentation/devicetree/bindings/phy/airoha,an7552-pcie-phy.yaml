## net/xpon/Kconfig
```kconfig
# SPDX-License-Identifier: GPL-2.0-only
menuconfig XPON
	tristate "xPON subsystem"
	depends on NETDEVICES
	help
	  Generic Passive Optical Network subsystem. It provides the common
	  representation used by GPON, EPON and XGS-PON devices, including
	  registration state, optical state, carrier, LEDs, sysfs and Generic
	  Netlink notifications.

if XPON

config XPON_MODE_KUNIT_TEST
	tristate "xPON mode and capability tests" if !KUNIT_ALL_TESTS
	depends on KUNIT
	default KUNIT_ALL_TESTS
	help
	  Test mode validation, high capability bits, provider failures and
	  sysfs mode reporting without optical hardware.
	  These tests do not exercise optical activation or the MAC datapath.
	  Say Y to run these tests at boot, or M to build a test module.

config XPON_PLOAM_KUNIT_TEST
	tristate "xPON PLOAM codec tests" if !KUNIT_ALL_TESTS
	depends on KUNIT
	default KUNIT_ALL_TESTS
	help
	  Test GPON and XGS-PON PLOAM wire layouts, bounds and reserved fields
	  without optical hardware. These tests do not validate activation or
	  MAC-specific FIFO and message integrity handling.
	  Say Y here to run these tests at boot, or M to build a test module.

config XPON_OMCI
	tristate "xPON OMCI agent and access line management"
	default y
	help
	  In-kernel ONU Management and Control Interface agent used by GPON and
	  XGS-PON providers. The protocol implementation is owned by the xPON
	  subsystem and is attached to one xPON device. The same Netlink family
	  also exposes local access line status for GPON, XG-PON, XGS-PON and
	  xDSL. Local xDSL management does not require an optical device or
	  create an OMCI transport over a copper line.

config XPON_OMCI_ACCESS_KUNIT_TEST
	bool "OMCI access line tests" if !KUNIT_ALL_TESTS
	depends on KUNIT=y && XPON_OMCI=y
	default KUNIT_ALL_TESTS
	help
	  Test line registration, removal, provider errors, PON mode reporting
	  and retrain dispatch without DSL or optical hardware.
	  Also verify 64-bit rate encoding and that removal waits for an
	  in-flight management callback before releasing provider storage.

config XPON_OMCI_KUNIT_TEST
	bool "OMCI service reconciliation tests" if !KUNIT_ALL_TESTS
	depends on KUNIT=y && XPON_OMCI=y
	default KUNIT_ALL_TESTS
	help
	  Test capacity validation, full-table reprovisioning, recovery after
	  provider failures and replay after a GPON restart without an OLT.
	  Use a fake provider with bounded capacity and injected failures.
	  Optical activation and packet forwarding are not exercised.

config XPON_OAM
	tristate "xPON IEEE 802.3ah OAM"
	default y
	help
	  IEEE 802.3 Ethernet OAM transport for EPON links. Complete Ethernet
	  frames are exposed through Generic Netlink with their local logical
	  link identity. Discovery, authentication and organization-specific
	  extensions are implemented by an OAM daemon in userspace.

endif # XPON

config XPON_KUNIT_TEST
	bool "xPON management lifecycle tests" if !KUNIT_ALL_TESTS
	depends on KUNIT=y && XPON=y
	default KUNIT_ALL_TESTS
	help
	  Exercise endpoint capacity, duplicate wire identifiers, stable netdev
	  identity, failed updates and removal using a hardware-free provider.
	  No optical hardware or OLT is required. These tests verify the
	  management object lifecycle independently of a protocol backend.
```
