## Documentation/devicetree/bindings/soc/airoha/econet,efuse-id.yaml
```yaml
# SPDX-License-Identifier: (GPL-2.0-only OR BSD-2-Clause)
%YAML 1.2
---
$id: http://devicetree.org/schemas/soc/airoha/econet,efuse-id.yaml#
$schema: http://devicetree.org/meta-schemas/core.yaml#

title: EcoNet EN7512 and EN7516 eFuse package identity shadow

maintainers:
  - Matheus Sampaio Queiroga <srherobrine20@gmail.com>

description: |
  The native-endian EFUSE_VERIFY_DATA0 word identifies the package variant
  within the family reported by NP SCU. This is a read-only shadow consumer
  interface, not an eFuse programming controller or the AFE calibration bank.

properties:
  compatible:
    items:
      - enum:
          - econet,en751221-efuse-id
          - econet,en751627-efuse-id
      - const: syscon

  reg:
    maxItems: 1

  native-endian: true

required:
  - compatible
  - reg
  - native-endian

additionalProperties: false

examples:
  - |
    syscon@1fbf8214 {
        compatible = "econet,en751221-efuse-id", "syscon";
        reg = <0x1fbf8214 0x4>;
        native-endian;
    };
```

## Documentation/devicetree/bindings/usb/econet,en7528-xhci.yaml
```yaml
# SPDX-License-Identifier: (GPL-2.0-only OR BSD-2-Clause)
%YAML 1.2
---
$id: http://devicetree.org/schemas/usb/econet,en7528-xhci.yaml#
$schema: http://devicetree.org/meta-schemas/core.yaml#

title: EcoNet EN7516, EN7528 and EN7580 USB3 xHCI host controllers

maintainers:
  - Matheus Sampaio Queiroga <srherobrine20@gmail.com>

allOf:
  - $ref: usb-xhci.yaml#

description:
  These controllers use the MediaTek xHCI host driver. EN7528 has one
  controller and EN7580 has two independent controllers. Each controller
  has a MAC register bank and an IP Port Control register bank.

properties:
  compatible:
    enum:
      - econet,en751627-xhci
      - econet,en7528-xhci
      - econet,en7580-xhci

  reg:
    items:
      - description: xHCI MAC registers
      - description: IP Port Control registers

  reg-names:
    items:
      - const: mac
      - const: ippc

  interrupts:
    maxItems: 1

  interrupt-names:
    items:
      - const: host

  phys:
    items:
      - description: USB2 PHY
      - description: USB3 PHY

  phy-names:
    items:
      - const: usb2-phy
      - const: usb3-phy

  vbus-supply:
    description: Regulator supplying USB VBUS

  vusb33-supply:
    description: Regulator supplying the USB 3.3 V rail

  resets:
    maxItems: 1

  usb3-lpm-capable: true

  usb2-lpm-disable: true

  mediatek,u2p-dis-msk:
    $ref: /schemas/types.yaml#/definitions/uint32
    description: Mask of disabled USB2 ports

  mediatek,u3p-dis-msk:
    $ref: /schemas/types.yaml#/definitions/uint32
    description: Mask of disabled USB3 ports

required:
  - compatible
  - reg
  - reg-names
  - interrupts
  - phys

unevaluatedProperties: false

examples:
  - |
    #include <dt-bindings/interrupt-controller/mips-gic.h>
    #include <dt-bindings/interrupt-controller/irq.h>
    #include <dt-bindings/phy/phy.h>

    usb@1fb90000 {
        compatible = "econet,en7580-xhci";
        reg = <0x1fb90000 0x4000>, <0x1fa84700 0x100>;
        reg-names = "mac", "ippc";
        interrupts = <GIC_SHARED 17 IRQ_TYPE_LEVEL_HIGH>;
        interrupt-names = "host";
        phys = <&usb_phy0 PHY_TYPE_USB2>, <&usb_phy0 PHY_TYPE_USB3>;
        phy-names = "usb2-phy", "usb3-phy";
        usb3-lpm-capable;
    };
```

## drivers/net/ethernet/airoha/Kconfig
```kconfig
# SPDX-License-Identifier: GPL-2.0-only
config NET_VENDOR_AIROHA
	bool "Airoha devices"
	depends on ARCH_AIROHA || ECONET || COMPILE_TEST
	help
	  If you have a Airoha or Econet SoC with ethernet, say Y.

if NET_VENDOR_AIROHA

config NET_AIROHA_NPU
	tristate "Airoha NPU support"
	depends on ARCH_AIROHA || COMPILE_TEST
	select WANT_DEV_COREDUMP
	select REGMAP_MMIO
	help
	  Support the Network Processor Unit available on newer Airoha SoCs.
	  The Ethernet and PPE drivers also work without this module by using
	  the CPU-direct PPE path. Enable this option when NPU firmware is
	  available and PPE statistics or firmware-assisted commits are needed.

config NET_AIROHA
	tristate "Airoha/EcoNet frame-engine Ethernet support"
	depends on OF
	select PHYLINK
	select PAGE_POOL
	imply NET_AIROHA_NPU if ARCH_AIROHA
	help
	  This driver supports the gigabit ethernet MACs in the
	  Airoha and Econet SoC family.

config NET_AIROHA_PPE_DEBUGFS
	bool
	default y
	depends on NET_AIROHA && DEBUG_FS
	help
	  Build the PPE debugfs interface for the shared Airoha/EcoNet
	  Ethernet driver.

config NET_AIROHA_FLOW_STATS
	default y
	bool "Airoha flow stats"
	depends on NET_AIROHA && NET_AIROHA_NPU
	help
	  Enable Airoha flowtable statistic counters.

config NET_AIROHA_SOC_WED
	bool "Airoha WED support"
	depends on NET_AIROHA && !NET_AIROHA_WHNAT && PCI
	select NET_MEDIATEK_WED_COMMON
	help
	  Enable WiFi Ethernet Datapath (WED) hardware offload.
	  When enabled, mt76 WiFi drivers can offload wireless
	  transmit processing through the WED engine rather than
	  taking the slow path through the CPU.

	  If unsure, say N.

config NET_AIROHA_WHNAT
	bool "EcoNet PPE WHNAT"
	depends on NET_AIROHA && (SOC_ECONET_EN751221 || COMPILE_TEST)
	select CFG80211_HEADERS
	help
	  Let PPE forward NAT flows from and to WiFi netdevs
	  whose radios have no WED support.

	  If unsure, say N.

config AIROHA_XPON
	tristate "Airoha xPON MAC driver"
	depends on ARCH_AIROHA || ECONET || COMPILE_TEST
	depends on NET_AIROHA
	depends on OF
	depends on SFP
	depends on OPTICAL_FRONTEND
	depends on MFD_SYSCON
	select PHY_AIROHA_XPON
	select XPON
	select XPON_OMCI
	select XPON_OAM
	help
	  Enable support for PON on ethernet driver for SoC familys support

config AIROHA_XDSL
	tristate "EcoNet xDSL frontend"
	depends on SOC_ECONET_EN751221 || SOC_ECONET_EN751627 || COMPILE_TEST
	depends on NET_AIROHA
	depends on OF
	help
	  Add support for xDSL Ethernet support on SoC Family have xDSL controllers

endif # NET_VENDOR_AIROHA
```

## drivers/net/optical/Kconfig
```kconfig
# SPDX-License-Identifier: GPL-2.0-only

menu "Optical frontend support"

config OPTICAL_FRONTEND
	tristate "Generic optical frontend core"
	help
	  Generic provider/consumer framework for soldered optical frontends such
	  as laser-diode drivers, limiting amplifiers and APD controllers used by
	  PON and other optical network devices.

	  The core intentionally sits beside PHYLIB/phylink: it represents the
	  analog optical frontend, not an Ethernet PHY or a serial PCS.

if OPTICAL_FRONTEND

config OPTICAL_FRONTEND_HWMON
	bool "Expose optical telemetry through hwmon"
	depends on HWMON
	default y
	help
	  Export normalized temperature, voltage, laser bias and Tx/Rx optical
	  power measurements through hwmon when a frontend provides them.

	  Alarm state and provider-supplied low/high thresholds are exported when
	  available. Say Y when standard hwmon userspace should monitor optics.

endif

source "drivers/net/optical/airoha/Kconfig"
source "drivers/net/optical/semtech/Kconfig"

endmenu
```

## drivers/net/optical/semtech/Kconfig
```kconfig
# SPDX-License-Identifier: GPL-2.0-only

config GN25L95_PHY
	tristate "Semtech GN25L9x/GN28L9x xPON optical frontend"
	depends on I2C
	select FW_LOADER
	select REGMAP_I2C
	select OPTICAL_FRONTEND
	help
	  Support the Semtech GN25L95/GN25L98 2.5 Gbit/s and GN28L96 10 Gbit/s
	  burst-mode laser drivers and limiting post amplifiers. GN28L96 supports
	  factory EEPROM calibration and board-specific host calibration in MCU
	  mode. Experimental GN28L98 support is limited to diagnostics on an
	  already-configured SFF-8472 interface; host calibration and transmitter
	  control are not implemented for that model.
	  The driver is an independent
	  provider of the generic optical frontend subsystem and is not tied to
	  Airoha MAC or PHY drivers.
```

## drivers/net/optical/ux/Kconfig
```kconfig
# SPDX-License-Identifier: GPL-2.0-only
config OPTICAL_FRONTEND_UX3320
	tristate "Xiamen UX UX3320B1 optical frontend"
	depends on I2C
	select FW_LOADER
	select OPTICAL_FRONTEND
	help
	  Support the UX3320B1 laser driver / limiting amplifier as an independent
	  optical frontend provider. Expose SFF-8472 telemetry and calibrated GPON
	  burst transmitter control. Load the board's final 768-byte register
	  image from NVMEM or firmware; no generic laser/APD calibration is used.
	  Missing calibration permits diagnostics but keeps the transmitter off.
	  UX3320S and EPON mode programming are not implemented.
```

## drivers/net/pcs/airoha/Kconfig
```kconfig
# SPDX-License-Identifier: GPL-2.0-only

config PCS_AIROHA
	tristate
	select FWNODE_PCS

config PCS_AIROHA_COMMON
	tristate
	select PCS_AIROHA

config PCS_AIROHA_AN7581
	tristate "Airoha AN7581 PCS driver"
	select PCS_AIROHA_COMMON
	help
	  This module provides helper to phylink for managing the Airoha
	  AN7581 PCS for SoC Ethernet and PON SERDES.

config PCS_AIROHA_AN7583
	tristate "Airoha AN7583 PCS driver"
	select PCS_AIROHA_COMMON
	help
	  This module provides helper to phylink for managing the Airoha
	  AN7583 PCS for SoC Ethernet and PON SERDES.

config PCS_AIROHA_EN7523
	tristate "Airoha EN7523 PCS driver"
	select PCS_AIROHA
	help
	  This module provides helper to phylink for managing the Airoha
	  EN7523 SGMII/HSGMII PCS for PON, PCIe and USB SERDES lanes.
```

## drivers/net/phy/airoha/Kconfig
```kconfig
config AIROHA_EN8801S_PHY
	tristate "Drivers for Airoha EN8801S Gigabit PHYs"
	help
	  Currently supports the Airoha EN8801S and AN8801 PHY.

config AIROHA_EN8811H_PHY
	tristate "Airoha EN8811H 2.5 Gigabit PHY"
	select PHY_COMMON_PROPS
	default n
	help
	  Currently supports the Airoha EN8811H PHY.
```

## drivers/phy/airoha/Kconfig
```kconfig
# SPDX-License-Identifier: GPL-2.0-only
#
# Phy drivers for Airoha devices
#
config PHY_AIROHA_PCIE
	tristate "Airoha PCIe-PHY Driver"
	depends on ARCH_AIROHA || COMPILE_TEST
	depends on OF
	select GENERIC_PHY
	help
	  Say Y here to add support for Airoha PCIe PHY driver.
	  This driver create the basic PHY instance and provides initialize
	  callback for PCIe GEN3 port.

config PHY_AIROHA_USB
	tristate "Airoha USB PHY Driver"
	depends on ARCH_AIROHA || COMPILE_TEST
	depends on OF
	select GENERIC_PHY
	help
	  Say 'Y' here to add support for Airoha USB PHY driver.
	  This driver create the basic PHY instance and provides initialize
	  callback for USB port.

config PHY_AIROHA_XPON
	tristate "Airoha/EcoNet xPON PHY driver"
	depends on ARCH_AIROHA || ECONET || COMPILE_TEST
	depends on OF
	depends on MFD_SYSCON
	select GENERIC_PHY
	help
	  Enable the digital GPON/EPON PHY found in Airoha EN7523-family and
	  EcoNet EN751221 SoCs. The driver programs the common xPON receiver,
	  selects the protocol mode and runs the SoC-specific PHY bring-up.

config PHY_AIROHA_AN7583_USB
	tristate "Airoha AN7583 USB PHY Driver"
	depends on ARCH_AIROHA || COMPILE_TEST
	depends on OF
	select GENERIC_PHY
	help
	  Say 'Y' here to add support for Airoha AN7583 USB PHY driver.
	  This driver create the basic PHY instance and provides initialize
	  callback for USB port.
```

## drivers/phy/airoha/xpon/Kconfig
```kconfig
# SPDX-License-Identifier: GPL-2.0-only
#
# PHY drivers for the xPON family
#
config PHY_AIROHA_XPON
	tristate "Airoha/EcoNet xPON PHY driver"
	depends on ARCH_AIROHA || ECONET || COMPILE_TEST
	depends on OF
	depends on MFD_SYSCON
	select GENERIC_PHY
	help
	  Enable the shared digital PHY API and provider infrastructure used by
	  the EcoNet and Airoha GPON, EPON and XGS-PON backends.

if PHY_AIROHA_XPON

config PHY_AIROHA_XPON_EN751221
	tristate "xPON PHY for EN751221"
	default y
	depends on PHY_AIROHA_XPON
	depends on ECONET || COMPILE_TEST

config PHY_AIROHA_XPON_EN7528
	tristate "xPON PHY for EN7528 and EN751627"
	default y
	depends on PHY_AIROHA_XPON
	depends on ECONET || COMPILE_TEST

config PHY_AIROHA_XPON_EN7580
	tristate "XGS-PON PHY for EN7580"
	default y
	depends on PHY_AIROHA_XPON
	depends on ECONET || COMPILE_TEST

config PHY_AIROHA_XPON_EN7523
	tristate "xPON PHY for EN7523"
	default y
	depends on PHY_AIROHA_XPON
	depends on ARCH_AIROHA || COMPILE_TEST

config PHY_AIROHA_XPON_AN758X
	tristate

config PHY_AIROHA_XPON_AN7581
	tristate "GPON/XGS-PON PHY for AN7581"
	select PHY_AIROHA_XPON_AN758X
	default y
	depends on PHY_AIROHA_XPON
	depends on ARCH_AIROHA || COMPILE_TEST

config PHY_AIROHA_XPON_AN7583
	tristate "GPON/XGS-PON PHY for AN7583"
	select PHY_AIROHA_XPON_AN758X
	default y
	depends on PHY_AIROHA_XPON
	depends on ARCH_AIROHA || COMPILE_TEST

config PHY_AIROHA_XPON_AN7552
	tristate "xPON PHY for AN7552"
	default y
	depends on PHY_AIROHA_XPON
	depends on ARCH_AIROHA || COMPILE_TEST

endif
```

## drivers/pinctrl/airoha/Kconfig
```kconfig
# SPDX-License-Identifier: GPL-2.0-only
menu "Airoha and EcoNet pinctrl drivers"
	depends on ARCH_AIROHA || ECONET || COMPILE_TEST

config PINCTRL_AIROHA
	tristate "Airoha pin control"
	depends on OF
	depends on ARCH_AIROHA || ECONET || COMPILE_TEST
	select MFD_SYSCON
	select PINMUX
	select GENERIC_PINCONF
	select GENERIC_PINCTRL_GROUPS
	select GENERIC_PINMUX_FUNCTIONS
	select GPIOLIB
	select GPIOLIB_IRQCHIP
	select REGMAP_MMIO
	imply PINCTRL_AIROHA_AN7563
	imply PINCTRL_AIROHA_AN7581
	imply PINCTRL_AIROHA_AN7583
	imply PINCTRL_AIROHA_EN7523
	imply PINCTRL_AIROHA_EN751221
	imply PINCTRL_AIROHA_EN7528
	imply PINCTRL_AIROHA_EN7580
	help
	  Shared pin controller and gpio driver code for different
	  Airoha and EcoNet SoCs.

config PINCTRL_AIROHA_AN7563
	tristate "AN7563 pinctrl"
	depends on ARM64 || COMPILE_TEST
	depends on PINCTRL_AIROHA

config PINCTRL_AIROHA_AN7581
	tristate "AN7581 pinctrl"
	depends on ARM64 || COMPILE_TEST
	depends on PINCTRL_AIROHA
	help
	  Say yes here to support pin controller and gpio driver
	  on Airoha AN7581, AN7566, AN7551 and other compatible SoCs.

config PINCTRL_AIROHA_AN7583
	tristate "AN7583 pinctrl"
	depends on ARM64 || COMPILE_TEST
	depends on PINCTRL_AIROHA
	help
	  Say yes here to support pin controller and gpio driver
	  on Airoha AN7583, AN7553, AN7567 and other compatible SoCs.

config PINCTRL_AIROHA_EN7523
	tristate "EN7523 pinctrl"
	depends on ARM || COMPILE_TEST
	depends on PINCTRL_AIROHA
	help
	  Say yes here to support pin controller and gpio driver
	  on Airoha EN7523, EN7529, EN7562 and other compatible SoCs.

config PINCTRL_AIROHA_EN751221
	tristate "EN7512/EN7521 pinctrl"
	depends on MIPS || COMPILE_TEST
	depends on PINCTRL_AIROHA
	help
	  Say yes here to support the GPIO and pin controller found in the
	  EcoNet EN7512, EN7513, EN7521 and EN7526 SoC families. The driver
	  provides GPIO, GPIO interrupt and pin multiplexing support through
	  the common Airoha pin controller implementation.

config PINCTRL_AIROHA_EN7528
	tristate "EN7528 pinctrl"
	depends on SOC_ECONET_EN7528 || COMPILE_TEST
	depends on PINCTRL_AIROHA
	help
	  Say yes here to support the GPIO and pin controller found in the
	  EcoNet EN7528 SoC through the common Airoha pin controller
	  implementation.

config PINCTRL_AIROHA_EN7580
	tristate "EN7580 pinctrl"
	depends on SOC_ECONET_EN7580 || COMPILE_TEST
	depends on PINCTRL_AIROHA
	help
	  Say yes here to support the GPIO and pin controller found in the
	  EcoNet EN7528 SoC through the common Airoha pin controller
	  implementation.

endmenu
```

## net/omci/Kconfig
```kconfig
# SPDX-License-Identifier: GPL-2.0-only
config OMCI
	tristate "ONU Management and Control Interface agent"
	depends on NET
	help
	  Provides an in-kernel baseline OMCI agent for GPON devices. The
	  subsystem parses OMCI requests, maintains the operational managed-
	  entity database, generates OLT responses, and exposes configuration,
	  MIB objects, events, and statistics through Generic Netlink. A small
	  stable subset of configuration, identity, channel state, and counters is
	  also available under /sys/class/omci for simple userspace consumers.

	  Extended OMCI parsing and hardware-specific provisioning remain
	  optional capabilities supplied by the GPON hardware driver.
```
