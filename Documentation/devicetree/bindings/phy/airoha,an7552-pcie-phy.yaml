## Documentation/devicetree/bindings/phy/airoha,an7552-pcie-phy.yaml
```yaml
# SPDX-License-Identifier: (GPL-2.0-only OR BSD-2-Clause)
%YAML 1.2
---
$id: http://devicetree.org/schemas/phy/airoha,an7552-pcie-phy.yaml#
$schema: http://devicetree.org/meta-schemas/core.yaml#

title: Airoha AN7552 and AN7563 PCIe PHY

maintainers:
  - Matheus Sampaio Queiroga <srherobrine20@gmail.com>

description: |
  The two PCIe PHY lanes share one provider. Initialization programs both
  lanes with the AN7552/AN7563 analog settings before the PCIe clock
  provider releases the endpoints from reset. This PHY does not use the
  EN7523 crystal-dependent PLL and power-saving sequence.

properties:
  compatible:
    enum:
      - airoha,an7552-pcie-phy
      - airoha,an7563-pcie-phy

  reg:
    items:
      - description: PCIe port 0 analog registers
      - description: PCIe port 1 analog registers

  reg-names:
    items:
      - const: pcie0
      - const: pcie1

  '#phy-cells':
    const: 0

required:
  - compatible
  - reg
  - reg-names
  - '#phy-cells'

additionalProperties: false

examples:
  - |
    phy@1fa93700 {
        compatible = "airoha,an7552-pcie-phy";
        reg = <0x1fa93700 0x568>, <0x1fa95700 0x568>;
        reg-names = "pcie0", "pcie1";
        #phy-cells = <0>;
    };
```

## Documentation/devicetree/bindings/phy/airoha,an7583-usb-phy.yaml
```yaml
# SPDX-License-Identifier: GPL-2.0-only OR BSD-2-Clause
%YAML 1.2
---
$id: http://devicetree.org/schemas/phy/airoha,an7583-usb-phy.yaml#
$schema: http://devicetree.org/meta-schemas/core.yaml#

title: Airoha AN7583 SoC USB PHY

maintainers:
  - Christian Marangi <ansuelsmth@gmail.com>

description: >
  The Airoha AN7583 SoC USB PHY describes the USB PHY for the USB controller.

  Unlike AN7581, where each USB port has its own PHY node, the AN7583 SoC has
  a single PHY block driving two USB 2.0 ports and one USB 3.0 port. Each port
  is described by a child node of the PHY block.

  USB 2.0 child nodes carry their offset in the "phy" register region and the
  oscillator to use for Slew Rate calibration. The USB 3.0 child node carries
  a phandle to the SCU, needed to switch the shared Serdes between USB and
  HSGMII mode.

properties:
  compatible:
    const: airoha,an7583-usb-phy

  reg:
    maxItems: 4

  reg-names:
    items:
      - const: phy
      - const: ana
      - const: pma
      - const: dig

  '#address-cells':
    const: 1

  '#size-cells':
    const: 0

patternProperties:
  '^usb2-phy@[0-9a-f]+$':
    type: object
    additionalProperties: false

    description: USB 2.0 port of the PHY block.

    properties:
      reg:
        maxItems: 1
        description: Offset of the port registers in the "phy" region.

      airoha,usb2-monitor-clk-sel:
        description: Describe what oscillator across the available 4
          should be selected for USB 2.0 Slew Rate calibration.
        $ref: /schemas/types.yaml#/definitions/uint32
        enum: [0, 1, 2, 3]

      '#phy-cells':
        const: 1

    required:
      - reg
      - airoha,usb2-monitor-clk-sel
      - '#phy-cells'

  '^usb3-phy$':
    type: object
    additionalProperties: false

    description: USB 3.0 port of the PHY block.

    properties:
      airoha,scu:
        description: Phandle to the SCU node, used to switch the shared
          Serdes between USB and HSGMII mode.
        $ref: /schemas/types.yaml#/definitions/phandle

      '#phy-cells':
        const: 1

    required:
      - airoha,scu
      - '#phy-cells'

required:
  - compatible
  - reg
  - reg-names
  - '#address-cells'
  - '#size-cells'

additionalProperties: false

examples:
  - |
    #include <dt-bindings/phy/airoha,an7581-usb-phy.h>

    phy@1fac0000 {
        compatible = "airoha,an7583-usb-phy";
        reg = <0x1fac0000 0x2000>,
              <0x1fa6f000 0x1000>,
              <0x1fa6e000 0x1000>,
              <0x1fa6a000 0x1000>;
        reg-names = "phy", "ana", "pma", "dig";

        #address-cells = <1>;
        #size-cells = <0>;

        usb2-phy@0 {
            reg = <0x0>;
            airoha,usb2-monitor-clk-sel = <AIROHA_USB2_MONCLK_SEL1>;

            #phy-cells = <1>;
        };

        usb2-phy@1000 {
            reg = <0x1000>;
            airoha,usb2-monitor-clk-sel = <AIROHA_USB2_MONCLK_SEL2>;

            #phy-cells = <1>;
        };

        usb3-phy {
            airoha,scu = <&scu>;

            #phy-cells = <1>;
        };
    };
```

## Documentation/devicetree/bindings/phy/airoha,en7523-xpon-phy.yaml
```yaml
# SPDX-License-Identifier: (GPL-2.0-only OR BSD-2-Clause)
%YAML 1.2
---
$id: http://devicetree.org/schemas/phy/airoha,en7523-xpon-phy.yaml#
$schema: http://devicetree.org/meta-schemas/core.yaml#

title: Airoha and EcoNet GPON and EPON PHY

maintainers:
  - Matheus Sampaio Queiroga <srherobrine20@gmail.com>

description: |
  Airoha EN7523/EN7528 and EcoNet EN751221 contain a digital xPON PHY shared by the
  GPON and EPON MAC engines. The generations share the GPON/EPON digital
  register block; EN7523 and EN7528 additionally integrate PMA/SerDes controls.
  AN7552 has a separate optical SerDes and LCPLL/CDR programming sequence.
  The optical PHY and the Ethernet PON PCS share the AN7552 SerDes and cannot
  be enabled simultaneously.
  AN7581 and AN7583 share the digital GEPON register block but have separate
  PON analog and PMA resources for their optical SerDes.

properties:
  compatible:
    enum:
      - airoha,an7552-xpon-phy
      - airoha,an7581-xpon-phy
      - airoha,an7583-xpon-phy
      - airoha,en7523-xpon-phy
      - airoha,en751627-xpon-phy
      - airoha,en7528-xpon-phy
      - econet,en751221-xpon-phy

  reg:
    minItems: 1
    maxItems: 3

  reg-names:
    items:
      - const: pcs
      - const: ana
      - const: pma

  interrupts:
    maxItems: 1
    description: Optional digital PHY interrupt; the driver may poll link state.

  interrupt-names:
    const: phy

  resets:
    maxItems: 1

  reset-names:
    const: phy

  airoha,scu:
    $ref: /schemas/types.yaml#/definitions/phandle
    description:
      Phandle to the SoC system-controller syscon used by the xPON PHY.

  airoha,chip-scu:
    $ref: /schemas/types.yaml#/definitions/phandle
    description:
      Phandle to the chip SCU. AN7552 uses offset 0x258 bit 19 to select
      whether its optical PLL needs K-band recovery.

  tx-disable-gpios:
    maxItems: 1
    description: |
      GPIO connected to the optical transmitter TX_DISABLE input. The GPIO
      polarity describes the asserted (transmitter disabled) level. The xPON
      PHY owns this signal and keeps it asserted while changing PHY mode.

  vcc-disable-gpios:
    maxItems: 1
    description: |
      Optional GPIO controlling the transmitter/BOSA power-disable input. The
      GPIO polarity describes the asserted (power disabled) level.

  airoha,tx-sd-inverted:
    type: boolean
    description:
      The optical transceiver drives transmit signal detect in the inverted
      sense.

  airoha,tx-fault-inverted:
    type: boolean
    description:
      The optical transceiver drives transmit fault in the inverted sense.

  airoha,rx-sd-inverted:
    type: boolean
    description: |
      The optical transceiver drives receive loss-of-signal rather than
      receive signal detect, so an asserted pin means light has been lost
      instead of light being present. Setting this on a board whose optics
      drive receive signal detect, or leaving it unset on a board whose
      optics drive loss-of-signal, makes the PHY report the optical link
      state inverted.

  airoha,burst-enable-inverted:
    type: boolean
    description:
      The optical transceiver expects burst enable in the inverted sense.

  '#phy-cells':
    const: 0

required:
  - compatible
  - reg
  - resets
  - reset-names
  - airoha,scu
  - '#phy-cells'

allOf:
  - if:
      properties:
        compatible:
          enum:
            - airoha,an7581-xpon-phy
            - airoha,an7583-xpon-phy
    then:
      properties:
        reg:
          minItems: 3
          maxItems: 3
      required:
        - reg-names
        - tx-disable-gpios
    else:
      properties:
        reg:
          maxItems: 1
        reg-names: false

  - if:
      properties:
        compatible:
          enum:
            - econet,en751221-xpon-phy
            - airoha,an7552-xpon-phy
    then:
      required:
        - airoha,chip-scu
    else:
      properties:
        airoha,chip-scu: false

  - if:
      properties:
        compatible:
          const: airoha,an7552-xpon-phy
    then:
      required:
        - tx-disable-gpios

additionalProperties: false

examples:
  - |
    #include <dt-bindings/gpio/gpio.h>
    #include <dt-bindings/reset/airoha,en7581-reset.h>

    phy@1faf0000 {
        compatible = "airoha,an7581-xpon-phy";
        reg = <0x1faf0000 0x1000>,
              <0x1fa8a000 0x1000>,
              <0x1fa8b000 0x1000>;
        reg-names = "pcs", "ana", "pma";
        resets = <&scuclk EN7581_XPON_PHY_RST>;
        reset-names = "phy";
        airoha,scu = <&scuclk>;
        tx-disable-gpios = <&pinctrl 38 GPIO_ACTIVE_HIGH>;
        #phy-cells = <0>;
    };

  - |
    #include <dt-bindings/reset/airoha,en7523-reset.h>

    phy@1faf0000 {
        compatible = "airoha,en7523-xpon-phy";
        reg = <0x1faf0000 0x5000>;
        resets = <&scuclk EN7523_XPON_PHY_RST>;
        reset-names = "phy";
        airoha,scu = <&scuclk>;
        #phy-cells = <0>;
    };

  - |
    #include <dt-bindings/reset/econet,en751221-scu.h>

    phy@1faf0000 {
        compatible = "econet,en751221-xpon-phy";
        reg = <0x1faf0000 0x600>;
        resets = <&scuclk EN751221_XPON_PHY_RST>;
        reset-names = "phy";
        airoha,scu = <&scuclk>;
        airoha,chip-scu = <&chip_scu>;
        #phy-cells = <0>;
    };
...
```

## Documentation/devicetree/bindings/phy/airoha,en7580-xpon-phy.yaml
```yaml
# SPDX-License-Identifier: (GPL-2.0-only OR BSD-2-Clause)
%YAML 1.2
---
$id: http://devicetree.org/schemas/phy/airoha,en7580-xpon-phy.yaml#
$schema: http://devicetree.org/meta-schemas/core.yaml#

title: Airoha EN7580 XGS-PON PHY

maintainers:
  - Matheus Sampaio Queiroga <srherobrine20@gmail.com>

description:
  The EN7580 has a 10G optical PCS and a PON PMA at offset 0x3000.
  These blocks use separate register ranges because the intervening window
  at offset 0x2000 belongs to the PCIe PHY. The Ethernet XFI PMA at offset
  0x6000 is also separate. Protocol selection is performed by the consumer.

properties:
  compatible:
    const: airoha,en7580-xpon-phy

  reg:
    items:
      - description: Optical PCS registers (0x1000 bytes).
      - description: PON PMA registers (0x1000 bytes).

  reg-names:
    items:
      - const: pcs
      - const: pma

  interrupts:
    maxItems: 1
    description: Digital PHY interrupt; the driver currently polls link state.

  interrupt-names:
    const: phy

  resets:
    maxItems: 1

  reset-names:
    const: phy

  airoha,scu:
    $ref: /schemas/types.yaml#/definitions/phandle
    description: NP system-controller syscon used for the WAN mux.

  tx-disable-gpios:
    maxItems: 1
    description:
      Optical transmitter TX_DISABLE input, described with its asserted
      disable polarity. It stays asserted until the consumer requests TX
      and the receiver synchronizes.

  vcc-disable-gpios:
    maxItems: 1
    description: Optional transceiver power-disable input, with disable polarity.

  airoha,tx-sd-inverted:
    type: boolean
    description: Transmit signal detect is active low.

  airoha,tx-fault-inverted:
    type: boolean
    description: Transmit fault is active low.

  airoha,rx-sd-inverted:
    type: boolean
    description:
      The transceiver drives active-high receive loss-of-signal instead of
      active-high receive signal detect.

  airoha,burst-enable-inverted:
    type: boolean
    description: Burst enable is active low.

  nvmem-cells:
    minItems: 3
    maxItems: 3
    description: Two-bit RX, TX positive and TX negative impedance trims.

  nvmem-cell-names:
    items:
      - const: rx-impedance
      - const: txp-impedance
      - const: txn-impedance

  '#phy-cells':
    const: 0

required:
  - compatible
  - reg
  - reg-names
  - resets
  - reset-names
  - airoha,scu
  - tx-disable-gpios
  - '#phy-cells'

dependentRequired:
  nvmem-cells: [nvmem-cell-names]
  nvmem-cell-names: [nvmem-cells]

additionalProperties: false

examples:
  - |
    #include <dt-bindings/gpio/gpio.h>
    #include <dt-bindings/reset/econet,en7580-scu.h>

    phy@1faf0000 {
        compatible = "airoha,en7580-xpon-phy";
        reg = <0x1faf0000 0x1000>, <0x1faf3000 0x1000>;
        reg-names = "pcs", "pma";
        resets = <&scuclk EN7580_XPON_PHY_RST>;
        reset-names = "phy";
        airoha,scu = <&scuclk>;
        tx-disable-gpios = <&pinctrl 38 GPIO_ACTIVE_HIGH>;
        #phy-cells = <0>;
    };
...
```

## Documentation/devicetree/bindings/phy/econet,en7528-usb-phy.yaml
```yaml
# SPDX-License-Identifier: (GPL-2.0-only OR BSD-2-Clause)
%YAML 1.2
---
$id: http://devicetree.org/schemas/phy/econet,en7528-usb-phy.yaml#
$schema: http://devicetree.org/meta-schemas/core.yaml#

title: EcoNet EN7516, EN7528 and EN7580 USB PHYs

maintainers:
  - Matheus Sampaio Queiroga <srherobrine20@gmail.com>

description:
  EN7528 has two USB2 PHYs sharing a frequency meter and one USB3 PHY.
  EN7580 has one USB2 PHY, one USB3 PHY and an independent frequency meter
  for each of its two host controllers. PHY_TYPE_USB2 and PHY_TYPE_USB3
  select the PHY type. EN7580 factory trims may be supplied through NVMEM.

properties:
  compatible:
    enum:
      - econet,en751627-usb-phy
      - econet,en7528-usb-phy
      - econet,en7580-usb-phy

  reg:
    maxItems: 1

  "#phy-cells":
    const: 1

  nvmem-cells:
    items:
      - description: USB2 internal current calibration
      - description: USB3 external current calibration
      - description: USB3 transmitter impedance calibration
      - description: USB3 receiver impedance calibration

  nvmem-cell-names:
    items:
      - const: u2-intr
      - const: u3-intr
      - const: tx-imp
      - const: rx-imp

dependencies:
  nvmem-cells: [nvmem-cell-names]
  nvmem-cell-names: [nvmem-cells]

required:
  - compatible
  - reg
  - "#phy-cells"

additionalProperties: false

examples:
  - |
    usb-phy@1fa80000 {
        compatible = "econet,en7580-usb-phy";
        reg = <0x1fa80000 0x1000>;
        #phy-cells = <1>;
    };
```
