## Documentation/devicetree/bindings/pinctrl/econet,en751221-pinctrl.yaml
```yaml
# SPDX-License-Identifier: (GPL-2.0 OR BSD-2-Clause)
%YAML 1.2
---
$id: http://devicetree.org/schemas/pinctrl/econet,en751221-pinctrl.yaml#
$schema: http://devicetree.org/meta-schemas/core.yaml#

title: EcoNet EN7512/EN7521 Pin Controller

maintainers:
  - Matheus Sampaio Queiroga <srherobrine20@gmail.com>

description: |
  Pin controller and GPIO block used by the EcoNet EN7512, EN7513, EN7521
  and EN7526 SoC families. The pin numbering follows the hardware pad map:
  GPIO0 starts at pinctrl pin 13. GPIO0 through GPIO28 are exposed by the
  GPIO controller through gpio-ranges, while additional pads can still be
  selected by pinmux functions.

properties:
  compatible:
    const: econet,en751221-pinctrl

  airoha,chip-scu:
    $ref: /schemas/types.yaml#/definitions/phandle
    description:
      Phandle to the chip system controller containing the I/O mux registers.

  interrupts:
    maxItems: 1

  gpio-controller: true

  '#gpio-cells':
    const: 2

  gpio-ranges:
    maxItems: 1

  interrupt-controller: true

  '#interrupt-cells':
    const: 2

allOf:
  - $ref: pinctrl.yaml#

required:
  - compatible
  - airoha,chip-scu
  - interrupts
  - gpio-controller
  - '#gpio-cells'
  - gpio-ranges
  - interrupt-controller
  - '#interrupt-cells'

patternProperties:
  '-pins$':
    type: object

    patternProperties:
      '^mux(-|$)':
        type: object
        $ref: /schemas/pinctrl/pinmux-node.yaml

        properties:
          function:
            enum:
              - pon
              - tod_1pps
              - sipo
              - uart
              - pon_i2c
              - dmt_i2c
              - ejtag
              - pcm
              - spi
              - pcm_spi
              - pcie_reset
              - pwm
              - phy0_led
              - phy1_led
              - phy2_led
              - phy3_led
              - phy4_led

          groups: true

        required:
          - function
          - groups

        allOf:
          - if:
              properties:
                function:
                  const: pon
            then:
              properties:
                groups:
                  enum: [pon]
          - if:
              properties:
                function:
                  const: tod_1pps
            then:
              properties:
                groups:
                  items:
                    enum:
                      - pon_tod_1pps
                      - gsw_tod_1pps
                      - dmt_tod_1pps
                  maxItems: 3
          - if:
              properties:
                function:
                  const: sipo
            then:
              properties:
                groups:
                  items:
                    enum:
                      - sipo
                      - sipo_rclk
                  maxItems: 2
          - if:
              properties:
                function:
                  const: uart
            then:
              properties:
                groups:
                  enum: [uart2]
          - if:
              properties:
                function:
                  const: pon_i2c
            then:
              properties:
                groups:
                  enum: [pon_i2c]
          - if:
              properties:
                function:
                  const: dmt_i2c
            then:
              properties:
                groups:
                  enum: [dmt_i2c]
          - if:
              properties:
                function:
                  const: ejtag
            then:
              properties:
                groups:
                  enum: [ejtag]
          - if:
              properties:
                function:
                  const: pcm
            then:
              properties:
                groups:
                  items:
                    enum:
                      - pcm1
                      - pcm2
                  maxItems: 2
          - if:
              properties:
                function:
                  const: spi
            then:
              properties:
                groups:
                  items:
                    enum:
                      - spi_quad
                      - spi2
                      - spi_cs3
                      - spi_cs4
                  maxItems: 4
          - if:
              properties:
                function:
                  const: pcm_spi
            then:
              properties:
                groups:
                  items:
                    enum:
                      - pcm_spi
                      - pcm_spi_int
                      - pcm_spi_rst
                      - pcm_spi_cs3
                      - pcm_spi_cs4
                  maxItems: 5
          - if:
              properties:
                function:
                  const: pcie_reset
            then:
              properties:
                groups:
                  items:
                    enum:
                      - pcie_reset0
                      - pcie_reset1
                  maxItems: 2
          - if:
              properties:
                function:
                  const: pwm
            then:
              properties:
                groups:
                  items:
                    enum:
                      - gpio0
                      - gpio1
                      - gpio2
                      - gpio3
                      - gpio4
                      - gpio5
                      - gpio6
                      - gpio7
                      - gpio8
                      - gpio9
                      - gpio10
                      - gpio11
                      - gpio12
                      - gpio13
                      - gpio14
                      - gpio15
                      - gpio16
                      - gpio17
                      - gpio18
                      - gpio19
                      - gpio20
                      - gpio21
                      - gpio22
                      - gpio23
                      - gpio24
                      - gpio25
                      - gpio26
                      - gpio27
                      - gpio28
                      - gpio29
                      - gpio30
                      - gpio31
                  maxItems: 32
          - if:
              properties:
                function:
                  const: phy0_led
            then:
              properties:
                groups:
                  items:
                    enum:
                      - gpio3
                      - gpio7
                      - gpio8
                      - gpio9
                      - gpio10
                  maxItems: 5
          - if:
              properties:
                function:
                  const: phy1_led
            then:
              properties:
                groups:
                  items:
                    enum:
                      - gpio3
                      - gpio7
                      - gpio8
                      - gpio9
                      - gpio10
                  maxItems: 5
          - if:
              properties:
                function:
                  const: phy2_led
            then:
              properties:
                groups:
                  items:
                    enum:
                      - gpio3
                      - gpio7
                      - gpio8
                      - gpio9
                      - gpio10
                  maxItems: 5
          - if:
              properties:
                function:
                  const: phy3_led
            then:
              properties:
                groups:
                  items:
                    enum:
                      - gpio3
                      - gpio7
                      - gpio8
                      - gpio9
                      - gpio10
                  maxItems: 5
          - if:
              properties:
                function:
                  const: phy4_led
            then:
              properties:
                groups:
                  items:
                    enum:
                      - gpio3
                      - gpio7
                      - gpio8
                      - gpio9
                      - gpio10
                  maxItems: 5

        additionalProperties: false

      '^conf(-|$)':
        type: object
        $ref: /schemas/pinctrl/pincfg-node.yaml

        properties:
          pins:
            items:
              enum:
                - uart1_txd
                - uart1_rxd
                - i2c_scl
                - i2c_sda
                - spi_cs
                - spi_clk
                - spi_mosi
                - spi_miso
                - mdio
                - mdc
                - gpio0
                - gpio1
                - gpio2
                - gpio3
                - gpio4
                - gpio5
                - gpio6
                - gpio7
                - gpio8
                - gpio9
                - gpio10
                - gpio11
                - gpio12
                - gpio13
                - gpio14
                - gpio15
                - gpio16
                - gpio17
                - gpio18
                - gpio19
                - gpio20
                - gpio21
                - gpio22
                - gpio23
                - gpio24
                - gpio25
                - gpio26
                - gpio27
                - gpio28
                - gpio29
                - pcie_reset0
                - pcie_reset1
            minItems: 1
            maxItems: 42

          bias-disable: true
          bias-pull-down: true
          bias-pull-up: true
          drive-strength:
            enum: [4, 8, 12, 16]
          input-enable: true
          output-enable: true
          output-low: true
          output-high: true

        required:
          - pins

        additionalProperties: false

    additionalProperties: false

additionalProperties: false

examples:
  - |
    pinctrl: pinctrl {
      compatible = "econet,en751221-pinctrl";
      airoha,chip-scu = <&chip_scu>;

      interrupt-parent = <&intc>;
      interrupts = <10>;

      gpio-controller;
      #gpio-cells = <2>;
      gpio-ranges = <&pinctrl 0 13 29>;

      interrupt-controller;
      #interrupt-cells = <2>;

      uart2-pins {
        mux {
          function = "uart";
          groups = "uart2";
        };
      };
    };
```

## Documentation/devicetree/bindings/serial/airoha,en7523-uart.yaml
```yaml
# SPDX-License-Identifier: (GPL-2.0-only OR BSD-2-Clause)
%YAML 1.2
---
$id: http://devicetree.org/schemas/serial/airoha,en7523-uart.yaml#
$schema: http://devicetree.org/meta-schemas/core.yaml#

title: Airoha and EcoNet UART

maintainers:
  - Benjamin Larsson <benjamin.larsson@genexis.eu>
  - Matheus Sampaio Queiroga <srherobrine20@gmail.com>

allOf:
  - $ref: serial.yaml#

properties:
  compatible:
    enum:
      - airoha,en7523-uart
      - airoha,en7581-hsuart

  reg:
    maxItems: 1

  reg-io-width:
    const: 4

  reg-shift:
    const: 2

  big-endian: true
  little-endian: true
  native-endian: true

  interrupts:
    maxItems: 1

  clock-frequency:
    description: |
      Crystal frequency. Older firmware may describe the effective clock
      after the fractional divider instead of the 20 MHz reference.

  clocks:
    minItems: 1
    maxItems: 2

  clock-names:
    minItems: 1
    items:
      - const: core
      - const: bus

  resets:
    maxItems: 1

  fifo-size:
    $ref: /schemas/types.yaml#/definitions/uint32
    minimum: 1

  auto-flow-control:
    type: boolean
    description: |
      Enable automatic RTS/CTS support. The board must route the RTS and
      CTS signals and select their pin multiplexing as well as TX and RX.

  no-loopback-test:
    type: boolean

  cts-gpios: true
  rts-gpios: true
  dtr-gpios: true
  dsr-gpios: true
  dcd-gpios: true
  rng-gpios: true

required:
  - compatible
  - reg
  - reg-io-width
  - reg-shift
  - interrupts

unevaluatedProperties: false

examples:
  - |
    serial@1fbe1000 {
      compatible = "airoha,en7581-hsuart";
      reg = <0x1fbe1000 0x40>;
      reg-io-width = <4>;
      reg-shift = <2>;
      interrupts = <54>;
      clock-frequency = <20000000>;
    };
  - |
    serial@1fbf0300 {
      compatible = "airoha,en7523-uart";
      reg = <0x1fbf0300 0x30>;
      reg-io-width = <4>;
      reg-shift = <2>;
      interrupts = <16>;
      clock-frequency = <20000000>;
    };
  - |
    #include <dt-bindings/interrupt-controller/arm-gic.h>

    pinctrl {
      uart2_pins: uart2 {
        mux {
          function = "uart";
          groups = "uart2";
        };
      };
    };

    uart1: serial@1fbf0000 {
      compatible = "airoha,en7523-uart";
      reg = <0x1fbf0000 0x30>;
      reg-io-width = <4>;
      reg-shift = <2>;
      clock-frequency = <20000000>;
      interrupts = <GIC_SPI 18 IRQ_TYPE_LEVEL_HIGH>;
    };

    uart2: serial@1fbf0300 {
      compatible = "airoha,en7523-uart";
      reg = <0x1fbf0300 0x30>;
      reg-io-width = <4>;
      reg-shift = <2>;
      clock-frequency = <20000000>;
      interrupts = <GIC_SPI 32 IRQ_TYPE_LEVEL_HIGH>;

      pinctrl-names = "default";
      pinctrl-0 = <&uart2_pins>;

      status = "disabled";
    };
  - |
    #include <dt-bindings/interrupt-controller/mips-gic.h>

    pinctrl {
      uart2_pins: uart2 {
        mux {
          function = "uart";
          groups = "uart2";
        };
      };

      uart3_pins: uart3 {
        mux {
          function = "uart";
          groups = "uart3";
        };
      };

      uart4_pins: uart4 {
        mux {
          function = "uart";
          groups = "uart4";
        };
      };

      uart5_pins: uart5 {
        mux {
          function = "uart";
          groups = "uart5";
        };
      };
    };

    uart1: serial@1fbf0000 {
      compatible = "airoha,en7523-uart";
      reg = <0x1fbf0000 0x30>;
      reg-io-width = <4>;
      reg-shift = <2>;
      native-endian;
      clock-frequency = <20000000>;

      interrupts = <GIC_SHARED 2 IRQ_TYPE_LEVEL_HIGH>;
    };

    uart2: serial@1fbf0300 {
      compatible = "airoha,en7523-uart";
      reg = <0x1fbf0300 0x30>;
      reg-io-width = <4>;
      reg-shift = <2>;
      native-endian;
      clock-frequency = <20000000>;

      interrupts = <GIC_SHARED 16 IRQ_TYPE_LEVEL_HIGH>;

      pinctrl-names = "default";
      pinctrl-0 = <&uart2_pins>;

      status = "disabled";
    };

    uart3: serial@1fbe1000 {
      compatible = "airoha,en7523-uart";
      reg = <0x1fbe1000 0x30>;
      reg-io-width = <4>;
      reg-shift = <2>;
      native-endian;
      clock-frequency = <20000000>;

      interrupts = <GIC_SHARED 38 IRQ_TYPE_LEVEL_HIGH>;

      pinctrl-names = "default";
      pinctrl-0 = <&uart3_pins>;

      status = "disabled";
    };

    uart4: serial@1fbf0600 {
      compatible = "airoha,en7523-uart";
      reg = <0x1fbf0600 0x30>;
      reg-io-width = <4>;
      reg-shift = <2>;
      native-endian;
      clock-frequency = <20000000>;

      interrupts = <GIC_SHARED 45 IRQ_TYPE_LEVEL_HIGH>;

      pinctrl-names = "default";
      pinctrl-0 = <&uart4_pins>;

      status = "disabled";
    };

    uart5: serial@1fbf0700 {
      compatible = "airoha,en7523-uart";
      reg = <0x1fbf0700 0x30>;
      reg-io-width = <4>;
      reg-shift = <2>;
      native-endian;
      clock-frequency = <20000000>;
      interrupts = <GIC_SHARED 46 IRQ_TYPE_LEVEL_HIGH>;

      pinctrl-names = "default";
      pinctrl-0 = <&uart5_pins>;

      status = "disabled";
    };
```
