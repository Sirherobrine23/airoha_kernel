## Documentation/devicetree/bindings/net/airoha,an7552-npu.yaml
```yaml
# SPDX-License-Identifier: (GPL-2.0-only OR BSD-2-Clause)
%YAML 1.2
---
$id: http://devicetree.org/schemas/net/airoha,an7552-npu.yaml#
$schema: http://devicetree.org/meta-schemas/core.yaml#

title: Airoha AN7552 Network Processor Unit

maintainers:
  - Lorenzo Bianconi <lorenzo@kernel.org>

description: |
  The AN7552 NPU V2-S has two RV32 cores, a 64 KiB data SRAM and six WLAN
  interrupt lines. Its watchdogs share one timer control register. Firmware
  runs from reserved DRAM; the firmware test area starts 2 MiB after the
  beginning of that region and requires another 64 KiB. Reserve at least
  0x210000 bytes; a 4 MiB region leaves room for firmware workspace.

properties:
  compatible:
    const: airoha,an7552-npu

  reg:
    maxItems: 1
    description: Data SRAM and registers starting at 0x1e900000.

  interrupts:
    items:
      - description: Mailbox interrupt to the host
      - description: WLAN interrupt 0
      - description: WLAN interrupt 1
      - description: WLAN interrupt 2
      - description: WLAN interrupt 3
      - description: WLAN interrupt 4
      - description: WLAN interrupt 5
      - description: Core 0 watchdog
      - description: Core 1 watchdog

  interrupt-names:
    items:
      - const: mbox
      - const: wlan0
      - const: wlan1
      - const: wlan2
      - const: wlan3
      - const: wlan4
      - const: wlan5
      - const: wdt0
      - const: wdt1

  airoha,scu:
    $ref: /schemas/types.yaml#/definitions/phandle
    description: SCU syscon providing the FPGA and L2 SRAM configuration.

  airoha,enable_npu_tx_uart:
    type: boolean
    description: Enable firmware diagnostic output on the NPU transmit UART.

  firmware-name:
    items:
      - description: AN7552 RV32 code image
      - description: AN7552 data SRAM image

  memory-region:
    minItems: 1
    items:
      - description: Firmware code and workspace in reserved DRAM
      - description: WLAN packet buffers

  memory-region-names:
    minItems: 1
    items:
      - const: firmware
      - const: pkt

required:
  - compatible
  - reg
  - interrupts
  - interrupt-names
  - airoha,scu
  - memory-region
  - memory-region-names

additionalProperties: false

examples:
  - |
    #include <dt-bindings/interrupt-controller/arm-gic.h>
    #include <dt-bindings/interrupt-controller/irq.h>

    npu@1e900000 {
        compatible = "airoha,an7552-npu";
        reg = <0x1e900000 0x313000>;
        interrupts = <GIC_SPI 125 IRQ_TYPE_LEVEL_HIGH>,
                     <GIC_SPI 118 IRQ_TYPE_LEVEL_HIGH>,
                     <GIC_SPI 119 IRQ_TYPE_LEVEL_HIGH>,
                     <GIC_SPI 120 IRQ_TYPE_LEVEL_HIGH>,
                     <GIC_SPI 121 IRQ_TYPE_LEVEL_HIGH>,
                     <GIC_SPI 122 IRQ_TYPE_LEVEL_HIGH>,
                     <GIC_SPI 123 IRQ_TYPE_LEVEL_HIGH>,
                     <GIC_SPI 134 IRQ_TYPE_LEVEL_HIGH>,
                     <GIC_SPI 135 IRQ_TYPE_LEVEL_HIGH>;
        interrupt-names = "mbox", "wlan0", "wlan1", "wlan2", "wlan3",
                          "wlan4", "wlan5", "wdt0", "wdt1";
        airoha,scu = <&scuclk>;
        memory-region = <&npu_binary>, <&npu_pkt>;
        memory-region-names = "firmware", "pkt";
    };
```

## Documentation/devicetree/bindings/net/airoha,an7552-phy.yaml
```yaml
# SPDX-License-Identifier: (GPL-2.0-only OR BSD-2-Clause)
%YAML 1.2
---
$id: http://devicetree.org/schemas/net/airoha,an7552-phy.yaml#
$schema: http://devicetree.org/meta-schemas/core.yaml#

title: Airoha AN7552 and AN7563 integrated Gigabit PHYs

maintainers:
  - Matheus Sampaio Queiroga <srherobrine20@gmail.com>

select:
  required:
    - airoha,mdi-resistor-ohms

allOf:
  - $ref: ethernet-phy.yaml#

properties:
  reg:
    minimum: 9
    maximum: 12

  airoha,mdi-resistor-ohms:
    enum: [0, 5]
    default: 5
    description: External MDI series resistance used by the board design.

  airoha,integrated-transformer:
    type: boolean
    description: Use the SDK compensation profile for an integrated transformer.

required:
  - reg

unevaluatedProperties: false
```

## Documentation/devicetree/bindings/net/airoha,en7523-wed.yaml
```yaml
# SPDX-License-Identifier: (GPL-2.0-only OR BSD-2-Clause)
%YAML 1.2
---
$id: http://devicetree.org/schemas/net/airoha,en7523-wed.yaml#
$schema: http://devicetree.org/meta-schemas/core.yaml#

title: Airoha EN7523 Wireless Ethernet Dispatch controller

maintainers:
  - Lorenzo Bianconi <lorenzo@kernel.org>

description:
  The Wireless Ethernet Dispatch (WED) controller connects a PCIe wireless
  DMA engine to the Ethernet frame engine and offloads the wireless transmit
  datapath. Each EN7523 WED instance is associated with one PCIe domain and
  one WDMA instance.

properties:
  compatible:
    items:
      - const: airoha,en7523-wed
      - const: syscon

  reg:
    items:
      - description: WED register block
      - description: WDMA register block

  reg-names:
    items:
      - const: wed
      - const: wdma

  interrupts:
    maxItems: 1

required:
  - compatible
  - reg
  - reg-names
  - interrupts

additionalProperties: false

examples:
  - |
    #include <dt-bindings/interrupt-controller/arm-gic.h>
    #include <dt-bindings/interrupt-controller/irq.h>

    wed@1fa02000 {
      compatible = "airoha,en7523-wed", "syscon";
      reg = <0x1fa02000 0xb00>,
            <0x1fa06000 0x400>;
      reg-names = "wed", "wdma";
      interrupts = <GIC_SPI 67 IRQ_TYPE_LEVEL_HIGH>;
    };
```

## Documentation/devicetree/bindings/net/airoha,en7523-xpon.yaml
```yaml
# SPDX-License-Identifier: (GPL-2.0-only OR BSD-2-Clause)
%YAML 1.2
---
$id: http://devicetree.org/schemas/net/airoha,en7523-xpon.yaml#
$schema: http://devicetree.org/meta-schemas/core.yaml#

title: Airoha and EcoNet shared GPON and EPON MAC

maintainers:
  - Matheus Sampaio Queiroga <srherobrine20@gmail.com>

description: |
  The Airoha EN7523 and EcoNet EN751221/EN7521 families contain one xPON
  MAC complex shared by the GPON and EPON protocol engines. Both generations
  use GDM2/CDM2 as the packet datapath and expose the xPON register region at
  0x1fb60000, with GPON at offset 0x4000 and EPON at offset 0x6000.

  EN7523 exposes a standalone xPON MAC interrupt. On EN751221-family MIPS
  SoCs the GPON/EPON MAC interrupt is aggregated by the WAN QDMA block and
  therefore is not described as a platform interrupt on this node.

properties:
  compatible:
    oneOf:
      - enum:
          - airoha,en7523-xpon
          - econet,en751221-xpon
          - econet,en7521-xpon
          - econet,en7526-xpon
      - enum:
          - airoha,en7523-gpon
          - airoha,en7523-epon
          - econet,en7521-gpon
          - econet,en7526-gpon
          - econet,en751221-gpon
          - econet,en7521-epon
          - econet,en7526-epon
          - econet,en751221-epon

  reg:
    minItems: 1
    maxItems: 4

  reg-names:
    minItems: 1
    items:
      - const: mac
      - enum: [tx-off, epon-reset]
      - const: epon-reset

  interrupts:
    minItems: 1
    maxItems: 2
    description:
      EN7523 xPON MAC interrupt followed by an optional platform
      power-fail/dying-gasp interrupt. EcoNet EN751221-family SoCs route the
      MAC interrupt through QDMA1 and normally omit this property.

  interrupt-names:
    minItems: 1
    items:
      - const: mac
      - const: dying-gasp

  resets:
    maxItems: 1
    description:
      Reset line for the shared xPON MAC register and table state. The driver
      pulses this reset before every GPON or EPON session start so no T-CONT,
      GEM, OMCC, encryption or activation state leaks between sessions.

  reset-names:
    const: mac

  ethernet:
    $ref: /schemas/types.yaml#/definitions/phandle
    description:
      Optional phandle to the GDM2 child used as the xPON datapath. When
      omitted, the driver discovers the SoC GDM2 netdev.

  airoha,scu:
    $ref: /schemas/types.yaml#/definitions/phandle
    description:
      Phandle to the SoC SCU syscon used to select GPON or EPON mode.

  airoha,pon-mode:
    description:
      Protocol engine selected for a unified *-xpon compatible. The property
      is optional and defaults to GPON. Legacy mode-specific compatibles do
      not require it.
    enum: [gpon, epon]

  airoha,gpon-serial-number:
    deprecated: true
    $ref: /schemas/types.yaml#/definitions/uint8-array
    minItems: 8
    maxItems: 8
    description:
      Eight-byte GPON serial number. The first four bytes are the vendor ID
      and the last four bytes are the vendor-specific serial number.

  airoha,gpon-password:
    deprecated: true
    $ref: /schemas/types.yaml#/definitions/uint8-array
    minItems: 10
    maxItems: 10
    description:
      Ten-byte GPON registration password. The driver must not expose the
      password through kernel logs.

  airoha,gpon-serial-from-mac:
    type: boolean
    description: |
      Derive the four-byte vendor-specific part of the GPON serial number
      from the last four octets of the GDM2 MAC address. The vendor prefix
      is supplied by omci-vendor-id. This is intended for boards whose stock
      firmware derives the optical serial number from the factory Ethernet
      address instead of storing a dedicated GPON serial number.

  phys:
    maxItems: 1
    description: Phandle to the SoC digital xPON PHY.

  phy-names:
    const: xpon

  sfp:
    $ref: /schemas/types.yaml#/definitions/phandle
    description: Phandle to the optical module or virtual SFP cage.

required:
  - compatible
  - reg
  - airoha,scu
  - sfp

dependencies:
  airoha,gpon-serial-from-mac:
    - omci-vendor-id

allOf:
  - $ref: /schemas/net/omci.yaml#
  - if:
      properties:
        compatible:
          enum:
            - airoha,en7523-xpon
            - econet,en751221-xpon
            - econet,en7521-xpon
            - econet,en7526-xpon
    then:
      required:
        - phys
        - phy-names
        - resets
        - reset-names
      properties:
        airoha,pon-mode: true
    else:
      required:
        - phys
        - phy-names
      properties:
        airoha,pon-mode: false
  - if:
      properties:
        compatible:
          enum:
            - airoha,en7523-xpon
            - airoha,en7523-gpon
            - airoha,en7523-epon
    then:
      required:
        - interrupts
        - interrupt-names

additionalProperties: true

examples:
  - |
    #include <dt-bindings/interrupt-controller/arm-gic.h>
    #include <dt-bindings/reset/airoha,en7523-reset.h>

    pon0: sfp {
        compatible = "sff,sfp";
        i2c-bus = <&i2c_sfp>;
    };

    xpon@1fb60000 {
        compatible = "airoha,en7523-xpon";
        reg = <0x1fb60000 0x10000>;
        reg-names = "mac";
        interrupts = <GIC_SPI 42 IRQ_TYPE_LEVEL_HIGH>;
        interrupt-names = "mac";
        resets = <&scuclk EN7523_XPON_MAC_RST>;
        reset-names = "mac";
        airoha,scu = <&scuclk>;
        airoha,pon-mode = "gpon";
        airoha,gpon-serial-number = [49 4e 56 50 71 43 86 02];
        airoha,gpon-password = [30 30 31 34 34 35 31 38 33 30];
        phys = <&xpon_phy>;
        phy-names = "xpon";
        sfp = <&pon0>;
    };
...
```

## Documentation/devicetree/bindings/net/airoha,en7572.yaml
```yaml
# SPDX-License-Identifier: (GPL-2.0-only OR BSD-2-Clause)
%YAML 1.2
---
$id: http://devicetree.org/schemas/net/airoha,en7572.yaml#
$schema: http://devicetree.org/meta-schemas/core.yaml#

title: Airoha EN7572, EN7573 and AN8901 optical frontends

maintainers:
  - Matheus Sampaio Queiroga <srherobrine20@gmail.com>

description: |
  Laser-driver and limiting-amplifier controllers with an embedded MD32.
  Each controller occupies I2C addresses 0x50 (A0) and 0x51 (A2). Describe
  only one device at 0x50; the driver also accesses 0x51 on the same bus.
  Both pages use 16-bit big-endian register addresses. CSR words are
  little-endian, while SFF-8472 diagnostics are big-endian.

  The compatible selects the chip and its MD32 firmware. The shared
  identity registers cannot distinguish EN7572 from EN7573. EN7573 uses
  airoha/en7573-pm.bin and airoha/en7573-dm.bin for program and data memory.
  Images must be nonempty, aligned to four bytes and fit in 16 KiB (PM)
  or 4 KiB (DM); unused memory is zero-filled.

  The BOB calibration image contains the A0 and A2 pages as 512 bytes in
  device order. It is not an EN7570/EN7571 table of 32-bit factory words:
  do not byte-swap it or insert a word-table signature at offset 0x94.
  The upper A2 page (image offsets 0x180 through 0x1ff) contains the
  default Tx and Rx calibration and must not be entirely erased or zero.

allOf:
  - $ref: optical-frontend.yaml#
  - $ref: /schemas/nvmem/nvmem-consumer.yaml#

properties:
  compatible:
    enum:
      - airoha,en7572
      - airoha,en7573
      - airoha,an8901

  reg:
    const: 0x50

  '#optical-frontend-cells':
    const: 0

  firmware-name:
    $ref: /schemas/types.yaml#/definitions/string
    description: |
      Optional name of the 512-byte BOB calibration firmware. Defaults to
      airoha/en7572-bob.bin, airoha/en7573-bob.bin or airoha/an8901-bob.bin,
      according to the compatible. A BOB NVMEM cell takes precedence.

  nvmem-cells:
    maxItems: 1
    description: Factory BOB calibration image (512 bytes).

  nvmem-cell-names:
    const: calibration

required:
  - compatible
  - reg
  - '#optical-frontend-cells'

dependentRequired:
  nvmem-cells:
    - nvmem-cell-names
  nvmem-cell-names:
    - nvmem-cells

unevaluatedProperties: false

examples:
  - |
    i2c {
        #address-cells = <1>;
        #size-cells = <0>;

        optical: optical-frontend@50 {
            compatible = "airoha,en7573";
            reg = <0x50>;
            #optical-frontend-cells = <0>;
            firmware-name = "airoha/en7573-bob.bin";
        };
    };
...
```
