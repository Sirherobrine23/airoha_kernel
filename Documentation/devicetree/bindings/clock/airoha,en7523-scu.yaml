## Documentation/devicetree/bindings/clock/airoha,en7523-scu.yaml
```yaml
# SPDX-License-Identifier: (GPL-2.0-only OR BSD-2-Clause)
%YAML 1.2
---
$id: http://devicetree.org/schemas/clock/airoha,en7523-scu.yaml#
$schema: http://devicetree.org/meta-schemas/core.yaml#

title: Airoha EN7523 System Control Unit clocks

maintainers:
  - Felix Fietkau <nbd@nbd.name>
  - John Crispin <nbd@nbd.name>

description: |
  The System Control Unit provides clocks and resets for Airoha SoCs. On
  EN7523 the provider can also expose the CPU PLL clock. New device trees
  describe CHIP-SCU through a phandle and provide NP-SCU and MCUCFG as named
  resources. The legacy combined two-resource EN7523 layout remains valid.

properties:
  compatible:
    oneOf:
      - const: airoha,en7523-scu
      - items:
          - const: airoha,en7523-scu
          - const: airoha,scuclk
          - const: syscon
      - const: airoha,en7581-scu

  reg:
    minItems: 1
    maxItems: 2

  reg-names:
    items:
      - const: np-scu
      - const: mcucfg
    minItems: 2
    maxItems: 2

  airoha,chip-scu:
    $ref: /schemas/types.yaml#/definitions/phandle
    description: Phandle to the EN7523 CHIP-SCU syscon.

  "#clock-cells":
    description: Clock identifier from include/dt-bindings/clock/en7523-clk.h.
    const: 1

  "#reset-cells":
    description: Reset identifier.
    const: 1

required:
  - compatible
  - reg
  - "#clock-cells"

allOf:
  - if:
      properties:
        compatible:
          contains:
            const: airoha,scuclk
    then:
      properties:
        reg:
          items:
            - description: NP-SCU registers
            - description: MCUCFG registers used while switching the CPU PLL
          minItems: 2
          maxItems: 2
      required:
        - reg-names
        - airoha,chip-scu

  - if:
      properties:
        compatible:
          const: airoha,en7523-scu
    then:
      properties:
        reg:
          items:
            - description: CHIP-SCU registers
            - description: NP-SCU registers
          minItems: 2
          maxItems: 2

  - if:
      properties:
        compatible:
          const: airoha,en7581-scu
    then:
      properties:
        reg:
          maxItems: 1
        reg-names: false
        airoha,chip-scu: false

additionalProperties: false

examples:
  - |
    #include <dt-bindings/clock/en7523-clk.h>

    chip_scu: syscon@1fa20000 {
      compatible = "airoha,chip-scu", "syscon";
      reg = <0x1fa20000 0x400>;
    };

    scuclk: system-controller@1fb00000 {
      compatible = "airoha,en7523-scu", "airoha,scuclk", "syscon";
      reg = <0x1fb00000 0x1000>,
            <0x1efbe000 0x800>;
      reg-names = "np-scu", "mcucfg";
      airoha,chip-scu = <&chip_scu>;
      #clock-cells = <1>;
      #reset-cells = <1>;
    };

  - |
    soc {
      #address-cells = <2>;
      #size-cells = <2>;

      scuclk: clock-controller@1fb00000 {
        compatible = "airoha,en7581-scu";
        reg = <0x0 0x1fb00000 0x0 0x970>;
        #clock-cells = <1>;
        #reset-cells = <1>;
      };
    };
```

## Documentation/devicetree/bindings/dma/econet,ecnt-gdma.yaml
```yaml
# SPDX-License-Identifier: (GPL-2.0-only OR BSD-2-Clause)
%YAML 1.2
---
$id: http://devicetree.org/schemas/dma/econet,ecnt-gdma.yaml#
$schema: http://devicetree.org/meta-schemas/core.yaml#

title: EcoNet general-purpose DMA block

maintainers:
  - Matheus Sampaio Queiroga <srherobrine20@gmail.com>

description: |
  The EcoNet GDMA block provides fixed-request and memory-copy channels used
  by several peripherals. In particular, the EN7512 and EN7516 DMT engines use
  GDMA channel zero for QAM data transfers, but the block is not part of the
  DMT register window and must be described as an independent SoC device.

properties:
  compatible:
    const: econet,ecnt-gdma

  reg:
    maxItems: 1

required:
  - compatible
  - reg

additionalProperties: false

examples:
  - |
    gdma@1fb30000 {
        compatible = "econet,ecnt-gdma";
        reg = <0x1fb30000 0x2b0>;
    };
```

## Documentation/devicetree/bindings/dma/econet,ecnt-hsdma.yaml
```yaml
# SPDX-License-Identifier: (GPL-2.0-only OR BSD-2-Clause)
%YAML 1.2
---
$id: http://devicetree.org/schemas/dma/econet,ecnt-hsdma.yaml#
$schema: http://devicetree.org/meta-schemas/core.yaml#

title: EcoNet high-speed DMA controller

maintainers:
  - Matheus Sampaio Queiroga <srherobrine20@gmail.com>

description: |
  The HSDMA controller found in EN7580 and later EcoNet/Airoha SoCs is a
  ring-based memory-to-memory DMA engine with two physical channels.

allOf:
  - $ref: dma-controller.yaml#

properties:
  compatible:
    const: econet,ecnt-hsdma

  reg:
    maxItems: 1

  interrupts:
    maxItems: 1

  "#dma-cells":
    description: DMA channel number.
    const: 1

  dma-channels:
    const: 2

  dma-requests:
    const: 2

required:
  - compatible
  - reg
  - interrupts
  - "#dma-cells"
  - dma-channels
  - dma-requests

unevaluatedProperties: false

examples:
  - |
    #include <dt-bindings/interrupt-controller/irq.h>
    #include <dt-bindings/interrupt-controller/mips-gic.h>

    dma-controller@1fa01800 {
        compatible = "econet,ecnt-hsdma";
        reg = <0x1fa01800 0x300>;
        interrupts = <GIC_SHARED 47 IRQ_TYPE_LEVEL_HIGH>;
        #dma-cells = <1>;
        dma-channels = <2>;
        dma-requests = <2>;
    };
```

## Documentation/devicetree/bindings/dma/econet,gdma.yaml
```yaml
# SPDX-License-Identifier: (GPL-2.0-only OR BSD-2-Clause)
%YAML 1.2
---
$id: http://devicetree.org/schemas/dma/econet,gdma.yaml#
$schema: http://devicetree.org/meta-schemas/core.yaml#

title: Airoha/EcoNet general DMA controller

maintainers:
  - Matheus Sampaio Queiroga <srherobrine20@gmail.com>

description: |
  The GDMA controller has eight channels with source, destination and control
  registers. Each hardware transfer can copy up to 65535 bytes. The DMA specifier
  selects a channel number from 0 to 7, rather than a peripheral request line.
  Only memory-to-memory copies are currently supported. Registers use native
  SoC byte order; EN751221 and EN751627 are big endian, the other variants are
  little endian. The EN7523 vendor Device Tree does not describe an interrupt,
  so the driver also supports polling for completion.

allOf:
  - $ref: dma-controller.yaml#

properties:
  compatible:
    enum:
      - econet,en751221-gdma
      - airoha,en7523-gdma

  reg:
    maxItems: 1

  interrupts:
    maxItems: 1

  resets:
    maxItems: 1

  '#dma-cells':
    const: 1

  dma-channels:
    const: 8

required:
  - compatible
  - reg
  - '#dma-cells'

additionalProperties: false

examples:
  - |
    #include <dt-bindings/interrupt-controller/irq.h>
    #include <dt-bindings/interrupt-controller/mips-gic.h>

    dma-controller@1fb30000 {
        compatible = "econet,en7580-gdma";
        reg = <0x1fb30000 0x1000>;
        interrupts = <GIC_SHARED 14 IRQ_TYPE_LEVEL_HIGH>;
        #dma-cells = <1>;
        dma-channels = <8>;
    };
```

## Documentation/devicetree/bindings/dma/econet,hsdma.yaml
```yaml
# SPDX-License-Identifier: (GPL-2.0-only OR BSD-2-Clause)
%YAML 1.2
---
$id: http://devicetree.org/schemas/dma/econet,hsdma.yaml#
$schema: http://devicetree.org/meta-schemas/core.yaml#

title: Airoha/EcoNet high-speed DMA controller

maintainers:
  - Matheus Sampaio Queiroga <srherobrine20@gmail.com>

description: |
  The HSDMA controller has two independent transmit/receive ring pairs and
  uses 32-byte little-endian descriptors with a 16-bit length field. The DMA
  specifier selects physical channel 0 or 1. Only memory copies are supported;
  this controller does not expose a slave peripheral request interface.

allOf:
  - $ref: dma-controller.yaml#

properties:
  compatible:
    enum:
      - econet,en7580-hsdma
      - airoha,en7523-hsdma

  reg:
    maxItems: 1

  interrupts:
    maxItems: 1

  resets:
    maxItems: 1

  '#dma-cells':
    const: 1

  dma-channels:
    const: 2

required:
  - compatible
  - reg
  - interrupts
  - '#dma-cells'

additionalProperties: false

examples:
  - |
    #include <dt-bindings/interrupt-controller/arm-gic.h>

    dma-controller@1fa01800 {
        compatible = "econet,en7523-hsdma";
        reg = <0x1fa01800 0x300>;
        interrupts = <GIC_SPI 63 IRQ_TYPE_LEVEL_HIGH>;
        #dma-cells = <1>;
        dma-channels = <2>;
    };
```

## Documentation/devicetree/bindings/memory-controllers/airoha,dramc.yaml
```yaml
# SPDX-License-Identifier: (GPL-2.0-only OR BSD-2-Clause)
%YAML 1.2
---
$id: http://devicetree.org/schemas/memory-controllers/airoha,dramc.yaml#
$schema: http://devicetree.org/meta-schemas/core.yaml#

title: Airoha/Econet DRAM Controller

maintainers:
  - Benjamin Larsson <benjamin.larsson@genexis.eu>

description:
  The Airoha/Econet DRAM controller block provides registers for DRAM
  controller and DDR PHY telemetry, including the configured DRAM protocol,
  channel topology, rank configuration, installed capacity and current data
  rate. Some SoCs expose the DDR PHY registers through a separate register
  range, while others place the DDR PHY registers inside the DRAM controller
  register range.

properties:
  compatible:
    enum:
      - econet,en751221-dramc
      - econet,en7528-dramc
      - econet,en7580-dramc
      - airoha,en7523-dramc
      - airoha,an7552-dramc
      - airoha,an7581-dramc
      - airoha,an7583-dramc

  reg:
    minItems: 1
    maxItems: 2

  reg-names:
    minItems: 1
    maxItems: 2
    items:
      - const: dramc
      - const: ddrphy

  airoha,chip-scu:
    $ref: /schemas/types.yaml#/definitions/phandle
    description:
      Phandle to the chip system-controller syscon used to read the crystal
      clock selection. Required on SoCs whose DRAM data-rate calculation
      depends on the chip SCU register block.

required:
  - compatible
  - reg
  - reg-names

allOf:
  - if:
      properties:
        compatible:
          contains:
            const: airoha,en7523-dramc
    then:
      properties:
        reg:
          minItems: 2
        reg-names:
          minItems: 2
      required:
        - airoha,chip-scu
    else:
      properties:
        reg:
          maxItems: 1
        reg-names:
          maxItems: 1

  - if:
      properties:
        compatible:
          contains:
            enum:
              - airoha,en7523-dramc
              - airoha,an7581-dramc
    then:
      required:
        - airoha,chip-scu
    else:
      properties:
        airoha,chip-scu: false

additionalProperties: false

examples:
  - |
    dramc: memory-controller@1fb24000 {
        compatible = "airoha,en7523-dramc";
        reg = <0x1fb24000 0x1000>,
              <0x1fb28000 0x1000>;
        reg-names = "dramc", "ddrphy";
        airoha,chip-scu = <&chip_scu>;
    };
```

## Documentation/devicetree/bindings/mfd/econet,en751221-gpio-sysctl.yaml
```yaml
# SPDX-License-Identifier: (GPL-2.0 OR BSD-2-Clause)
%YAML 1.2
---
$id: http://devicetree.org/schemas/mfd/econet,en751221-gpio-sysctl.yaml#
$schema: http://devicetree.org/meta-schemas/core.yaml#

title: EcoNet EN7512/EN7521 GPIO System Controller

maintainers:
  - Matheus Sampaio Queiroga <srherobrine20@gmail.com>

description:
  GPIO register block and MFD container used by the EcoNet EN7512, EN7513,
  EN7521 and EN7526 SoC families.

properties:
  compatible:
    items:
      - const: econet,en751221-gpio-sysctl
      - const: syscon
      - const: simple-mfd

  reg:
    maxItems: 1

  pinctrl:
    type: object
    $ref: /schemas/pinctrl/econet,en751221-pinctrl.yaml

required:
  - compatible
  - reg
  - pinctrl

additionalProperties: false

examples:
  - |
    system-controller@1fbf0200 {
      compatible = "econet,en751221-gpio-sysctl", "syscon", "simple-mfd";
      reg = <0x1fbf0200 0x7c>;

      pinctrl: pinctrl {
        compatible = "econet,en751221-pinctrl";
        airoha,chip-scu = <&chip_scu>;

        interrupt-parent = <&intc>;
        interrupts = <10>;

        gpio-controller;
        #gpio-cells = <2>;
        gpio-ranges = <&pinctrl 0 13 29>;

        interrupt-controller;
        #interrupt-cells = <2>;
      };
    };
```

## Documentation/devicetree/bindings/net/airoha,an7552-eth.yaml
```yaml
# SPDX-License-Identifier: (GPL-2.0-only OR BSD-2-Clause)
%YAML 1.2
---
$id: http://devicetree.org/schemas/net/airoha,an7552-eth.yaml#
$schema: http://devicetree.org/meta-schemas/core.yaml#

title: Airoha AN7552 and AN7563 Frame Engine

maintainers:
  - Matheus Sampaio Queiroga <srherobrine20@gmail.com>

description: |
  AN7552 and AN7563 have two QDMA engines and an integrated Gigabit switch.
  The switch CPU port connects to GDM1. The initial driver supports the
  copper LAN datapath; PON and Ethernet SerDes require separate providers.

properties:
  compatible:
    oneOf:
      - const: airoha,an7552-eth
      - items:
          - const: airoha,an7563-eth
          - const: airoha,an7552-eth

  reg:
    items:
      - description: Frame engine registers
      - description: QDMA LAN registers
      - description: QDMA WAN registers
      - description: GDMP SRAM configuration

  reg-names:
    items:
      - const: fe
      - const: qdma0
      - const: qdma1
      - const: gdmp

  interrupts:
    minItems: 10
    maxItems: 10

  interrupt-names:
    items:
      - const: lan0
      - const: lan1
      - const: lan2
      - const: lan3
      - const: wan0
      - const: wan1
      - const: wan2
      - const: wan3
      - const: fe-error
      - const: pdma

  resets:
    items:
      - description: Frame engine reset
      - description: PDMA reset
      - description: QDMA reset

  reset-names:
    items:
      - const: fe
      - const: pdma
      - const: qdma

  memory-region:
    items:
      - description: QDMA LAN forwarding payload memory
      - description: QDMA WAN forwarding payload memory

  memory-region-names:
    items:
      - const: qdma0-buf
      - const: qdma1-buf

  '#address-cells':
    const: 1

  '#size-cells':
    const: 0

  ethernet@1:
    type: object
    $ref: ethernet-controller.yaml#
    unevaluatedProperties: false
    properties:
      compatible:
        const: airoha,eth-mac
      reg:
        const: 1
    required:
      - compatible
      - reg
      - phy-mode

required:
  - compatible
  - reg
  - reg-names
  - interrupts
  - interrupt-names
  - resets
  - reset-names
  - '#address-cells'
  - '#size-cells'

additionalProperties: false
```
