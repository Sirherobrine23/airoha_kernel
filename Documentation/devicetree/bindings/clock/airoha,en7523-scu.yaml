## Documentation/devicetree/bindings/net/pcs/airoha,en7523-pcs.yaml
```yaml
# SPDX-License-Identifier: (GPL-2.0-only OR BSD-2-Clause)
%YAML 1.2
---
$id: http://devicetree.org/schemas/net/pcs/airoha,en7523-pcs.yaml#
$schema: http://devicetree.org/meta-schemas/core.yaml#

title: Airoha EN7523 SGMII/HSGMII PCS

maintainers:
  - Matheus Sampaio Queiroga <srherobrine20@gmail.com>

description:
  The EN7523 exposes SGMII/HSGMII PCS blocks on the PON, PCIe0, PCIe1 and
  USB3 SerDes lanes. The PCIe lanes share one PCS provider and use one cell
  to select the lane index.

properties:
  compatible:
    enum:
      - airoha,en7523-pcs-pon
      - airoha,en7523-pcs-pcie
      - airoha,en7523-pcs-usb

  reg:
    minItems: 5
    maxItems: 12

  reg-names:
    minItems: 1
    maxItems: 12

  airoha,scu:
    $ref: /schemas/types.yaml#/definitions/phandle
    description: Phandle to the EN7523 NP SCU syscon.

  resets:
    minItems: 1
    maxItems: 2

  reset-names:
    items:
      - const: mac
      - const: phy

  phys:
    maxItems: 1

  '#pcs-cells': true

  status: true

required:
  - compatible
  - reg
  - airoha,scu
  - '#pcs-cells'

allOf:
  - if:
      properties:
        compatible:
          contains:
            const: airoha,en7523-pcs-pcie
    then:
      properties:
        reg:
          minItems: 12
          maxItems: 12
        '#pcs-cells':
          const: 1

  - if:
      properties:
        compatible:
          contains:
            enum:
              - airoha,en7523-pcs-pon
              - airoha,en7523-pcs-usb
    then:
      properties:
        reg:
          minItems: 5
          maxItems: 6
        '#pcs-cells':
          const: 0

additionalProperties: false

examples:
  - |
    #include <dt-bindings/clock/en7523-clk.h>
    #include <dt-bindings/reset/airoha,en7523-reset.h>

    pcs@1fa04000 {
        compatible = "airoha,en7523-pcs-pcie";
        reg = <0x1fa70000 0x1000>,
              <0x1fa71000 0x1000>,
              <0x1fa72100 0x4a0>,
              <0x1fa72a00 0x160>,
              <0x1fa72000 0x64>,
              <0x1fa72600 0xdc>,
              <0x1fa72c00 0x3b0>,
              <0x1fa77100 0x4a0>,
              <0x1fa77a00 0x160>,
              <0x1fa77000 0x64>,
              <0x1fa77600 0xdc>,
              <0x1fa77c00 0x3b0>;
        reg-names = "pcs_mac0", "pcs_mac1";
        airoha,scu = <&scuclk>;
        #pcs-cells = <1>;
    };

  - |
    #include <dt-bindings/clock/en7523-clk.h>
    #include <dt-bindings/reset/airoha,en7523-reset.h>

    pcs@1fa08000 {
        compatible = "airoha,en7523-pcs-pon";
        reg = <0x1fa60000 0x1000>,
              <0x1fa65100 0x4a0>,
              <0x1fa65a00 0x1ac>,
              <0x1fa65e00 0x64>,
              <0x1fa66000 0xdc>;
        reg-names = "pcs_mac";
        resets = <&scuclk EN7523_XPON_MAC_RST>,
                 <&scuclk EN7523_XPON_PHY_RST>;
        reset-names = "mac", "phy";
        airoha,scu = <&scuclk>;
        #pcs-cells = <0>;
    };

  - |
    #include <dt-bindings/phy/phy.h>

    pcs@1fa07000 {
        compatible = "airoha,en7523-pcs-usb";
        reg = <0x1fa80000 0x1000>,
              <0x1fa81100 0x4a0>,
              <0x1fa81a00 0x160>,
              <0x1fa81000 0x64>,
              <0x1fa81600 0xdc>,
              <0x1fa81c00 0x3b0>;
        reg-names = "pcs_mac";
```

## Documentation/devicetree/bindings/net/pcs/airoha,en7580-pcs.yaml
```yaml
# SPDX-License-Identifier: (GPL-2.0-only OR BSD-2-Clause)
%YAML 1.2
---
$id: http://devicetree.org/schemas/net/pcs/airoha,en7580-pcs.yaml#
$schema: http://devicetree.org/meta-schemas/core.yaml#

title: Airoha EN7580 Ethernet XSI PCS

maintainers:
  - Matheus Sampaio Queiroga <srherobrine20@gmail.com>

description:
  The EN7580 Ethernet XSI lane has an XSI MAC, a dedicated PMA and XFI/HSGMII
  digital PCS blocks. This lane is separate from the optical PON PMA.
  Negotiation is managed by the external Ethernet PHY.

properties:
  compatible:
    const: airoha,en7580-pcs

  reg:
    items:
      - description: XSI MAC
      - description: XSI PMA
      - description: XFI and HSGMII digital PCS blocks

  reg-names:
    items:
      - const: mac
      - const: pma
      - const: pcs

  airoha,scu:
    $ref: /schemas/types.yaml#/definitions/phandle
    description: NP SCU syscon.

  airoha,chip-scu:
    $ref: /schemas/types.yaml#/definitions/phandle
    description: Chip SCU syscon.

  '#pcs-cells':
    const: 0

required:
  - compatible
  - reg
  - reg-names
  - airoha,scu
  - airoha,chip-scu
  - '#pcs-cells'

additionalProperties: false

examples:
  - |
    pcs@1fa04000 {
        compatible = "airoha,en7580-pcs";
        reg = <0x1fa04000 0x200>,
              <0x1faf6000 0x1000>,
              <0x1faf7900 0x1000>;
        reg-names = "mac", "pma", "pcs";
        airoha,scu = <&scuclk>;
        airoha,chip-scu = <&chip_scu>;
        #pcs-cells = <0>;
    };
```

## Documentation/devicetree/bindings/net/semtech,gn25l95.yaml
```yaml
# SPDX-License-Identifier: (GPL-2.0-only OR BSD-2-Clause)
%YAML 1.2
---
$id: http://devicetree.org/schemas/net/semtech,gn25l95.yaml#
$schema: http://devicetree.org/meta-schemas/core.yaml#

title: Semtech GN25L95 and GN25L98 xPON optical frontends

maintainers:
  - Matheus Sampaio Queiroga <srherobrine20@gmail.com>

description: |
  The GN25L95 and GN25L98 are 2.5 Gbit/s burst-mode laser drivers and limiting
  post amplifiers intended for GPON and EPON optical network units. They
  provide SFF-8472 compatible digital diagnostics over I2C. The host A2 page
  normally appears at 7-bit address 0x51; the address can be changed by device
  NVM.

properties:
  compatible:
    enum:
      - semtech,gn25l95
      - semtech,gn25l98

  reg:
    maxItems: 1
    description:
      I2C address of the GN25L95/GN25L98 A2 host page, normally 0x51.

  '#optical-frontend-cells':
    const: 0
    description:
      The device exposes one optical frontend provider.

  nvmem-cells:
    maxItems: 1
    description: |
      BOSA calibration cell. On the Nokia GN25L98 this is a 128-byte
      CRC-protected manufacturer parameter record used to derive the Semtech
      register tables; a 640-byte already-calibrated image is also accepted.
      GN25L95 uses its 2048-byte calibrated register image. An explicitly
      supplied NVMEM cell takes precedence over firmware-name.

  nvmem-cell-names:
    items:
      - const: calibration

  firmware-name:
    $ref: /schemas/types.yaml#/definitions/string
    description: |
      Name of the board-specific BOSA calibration image. GN25L95 uses the
      2048-byte MediaTek/EcoNet /bosa/hwconfig layout. GN25L98 uses a 640-byte
      final calibrated image containing table 6, table 5, table 4, table 2 and
      table 0, each occupying 128 bytes. The table 6 block must contain the
      board-specific APD LUT in bytes 0x00..0x3f. GN25L98 calibration images
      must not be reused on GN25L95 devices. If no NVMEM calibration cell
      is provided, the driver requests the chip-specific
      semtech/gn25l95-hwconfig.bin or semtech/gn25l98-hwconfig.bin image.

  nvmem-cells:
    maxItems: 1
    description: |
      Optional board-specific, already formatted Semtech hwconfig image. The
      cell must contain exactly 2048 bytes for GN25L95 or 640 bytes for
      GN25L98. This is not the Nokia 2048-byte manufacturing/BOSA metadata
      record. When supplied, NVMEM is used in preference to firmware-name.

  nvmem-cell-names:
    items:
      - const: calibration

required:
  - compatible
  - reg
  - '#optical-frontend-cells'

dependencies:
  nvmem-cells: [nvmem-cell-names]
  nvmem-cell-names: [nvmem-cells]

additionalProperties: false

examples:
  - |
    i2c {
        #address-cells = <1>;
        #size-cells = <0>;

        optical-frontend@51 {
            compatible = "semtech,gn25l98";
            reg = <0x51>;
            #optical-frontend-cells = <0>;
            firmware-name = "semtech/board-gn25l98-hwconfig.bin";
        };
    };
```

## Documentation/devicetree/bindings/net/semtech,gn28l96.yaml
```yaml
# SPDX-License-Identifier: (GPL-2.0-only OR BSD-2-Clause)
%YAML 1.2
---
$id: http://devicetree.org/schemas/net/semtech,gn28l96.yaml#
$schema: http://devicetree.org/meta-schemas/core.yaml#

title: Semtech GN28L96 and GN28L98 10 Gbit/s optical frontends

maintainers:
  - Matheus Sampaio Queiroga <srherobrine20@gmail.com>

description: |
  The GN28L96 and GN28L98 integrate a burst-mode laser driver, limiting
  amplifier and APD controller for 10 Gbit/s PON ONUs. The host interface
  normally uses 7-bit I2C address 0x51 for A2 diagnostics and control.
  The GN28L96 also supports external MCU mode with board-specific host
  calibration. GN28L98 support currently covers only an already-configured
  SFF-8472 diagnostics interface. Its vendor configuration registers and
  MCU calibration sequence have not been validated against a datasheet.

properties:
  compatible:
    enum:
      - semtech,gn28l96
      - semtech,gn28l98

  reg:
    maxItems: 1
    description: I2C address of the A2 host interface, normally 0x51.

  '#optical-frontend-cells':
    const: 0

  firmware-name:
    $ref: /schemas/types.yaml#/definitions/string
    description: |
      Board-specific GN28L96 calibration image, used only in MCU mode.
      The 1024-byte layout contains 256-byte A0 and A2 blocks followed by
      128-byte tables 80, 81, 82 and 83. A 1408-byte image appends tables
      84, 85 and 86. The extended image is required if any LUT in those
      tables is enabled. A0, live diagnostics, I2C addressing and access
      permissions are not programmed. The driver defaults to
      semtech/gn28l96-hwconfig.bin in MCU mode. Factory EEPROM mode does
      not request firmware. GN25L95/GN25L98 images are incompatible.

  semtech,password:
    $ref: /schemas/types.yaml#/definitions/uint32
    description: |
      Board-programmed password for access to GN28L96 vendor tables.
      Written most significant byte first to A2 registers 0x7b through
      0x7e. Omit when the required tables are already accessible.

allOf:
  - if:
      properties:
        compatible:
          const: semtech,gn28l98
    then:
      properties:
        firmware-name: false
        semtech,password: false

required:
  - compatible
  - reg
  - '#optical-frontend-cells'

additionalProperties: false

examples:
  - |
    i2c {
        #address-cells = <1>;
        #size-cells = <0>;

        optical-frontend@51 {
            compatible = "semtech,gn28l96";
            reg = <0x51>;
            #optical-frontend-cells = <0>;
            firmware-name = "semtech/board-gn28l96-hwconfig.bin";
        };
    };
```

## Documentation/devicetree/bindings/net/ux,ux3320b1.yaml
```yaml
# SPDX-License-Identifier: (GPL-2.0-only OR BSD-2-Clause)
%YAML 1.2
---
$id: http://devicetree.org/schemas/net/ux,ux3320b1.yaml#
$schema: http://devicetree.org/meta-schemas/core.yaml#

title: Xiamen UX UX3320B1 optical frontend

maintainers:
  - Matheus Sampaio Queiroga <srherobrine20@gmail.com>

description: |
  UX3320B1 is an optical transceiver controller used with an external BOSA.
  Its SFF-8472 A2 interface uses an 8-bit bank selector at 0x7f for the upper
  128-byte register window. The chip handles the calibrated optical loops.
  TX_DISABLE, RX_LOS and burst-enable board signals belong to the digital
  PHY consumer, not this I2C provider.

properties:
  compatible:
    const: ux,ux3320b1

  reg:
    maxItems: 1

  '#optical-frontend-cells':
    const: 0

  nvmem-cells:
    maxItems: 1
    description:
      Board-specific calibrated register image in the 768-byte format exported
      by the AOT4221NK stock driver. This is not its cfg.bob factory record.

  nvmem-cell-names:
    items:
      - const: calibration

  firmware-name:
    $ref: /schemas/types.yaml#/definitions/string
    description: |
      Board-specific final calibrated register image. The 768 bytes contain
      the A2 lower half followed by upper banks 0, 3, 4, 5 and 6, each in a
      128-byte slot. NVMEM takes precedence. If absent, request
      ux/ux3320b1-hwconfig.bin. Missing calibration leaves TX disabled.

required:
  - compatible
  - reg
  - '#optical-frontend-cells'

dependencies:
  nvmem-cells: [nvmem-cell-names]
  nvmem-cell-names: [nvmem-cells]

additionalProperties: false

examples:
  - |
    i2c {
        #address-cells = <1>;
        #size-cells = <0>;

        optical-frontend@51 {
            compatible = "ux,ux3320b1";
            reg = <0x51>;
            #optical-frontend-cells = <0>;
            firmware-name = "ux/aot4221nk-ux3320b1-hwconfig.bin";
        };
    };
```

## Documentation/devicetree/bindings/nvmem/econet,en7580-efuse.yaml
```yaml
# SPDX-License-Identifier: (GPL-2.0-only OR BSD-2-Clause)
%YAML 1.2
---
$id: http://devicetree.org/schemas/nvmem/econet,en7580-efuse.yaml#
$schema: http://devicetree.org/meta-schemas/core.yaml#

title: EcoNet EN7580 eFuse shadow

maintainers:
  - Matheus Sampaio Queiroga <srherobrine20@gmail.com>

description:
  The EN7580 exposes a byte-addressed eFuse shadow containing package and
  factory calibration data. This is the region read by the vendor
  package-info parser. Only read access to the shadow is supported.

allOf:
  - $ref: nvmem.yaml#

properties:
  compatible:
    const: econet,en7580-efuse

  reg:
    maxItems: 1

  read-only: true

required:
  - compatible
  - reg

unevaluatedProperties: false

examples:
  - |
    efuse@1fa40b00 {
        compatible = "econet,en7580-efuse";
        reg = <0x1fa40b00 0x3c>;
        read-only;

        nvmem-layout {
            compatible = "fixed-layout";
            #address-cells = <1>;
            #size-cells = <1>;

            usb3-tx-imp@6 {
                reg = <0x6 0x2>;
                bits = <4 5>;
            };
        };
    };
```
