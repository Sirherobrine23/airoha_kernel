## Documentation/devicetree/bindings/net/airoha,en7580-xpon.yaml
```yaml
# SPDX-License-Identifier: (GPL-2.0-only OR BSD-2-Clause)
%YAML 1.2
---
$id: http://devicetree.org/schemas/net/airoha,en7580-xpon.yaml#
$schema: http://devicetree.org/meta-schemas/core.yaml#

title: Airoha EN7580 XGS-PON MAC

maintainers:
  - Matheus Sampaio Queiroga <srherobrine20@gmail.com>

description: |
  The MIPS EN7580 contains a 10G PON MAC engine at offset 0x5000 in the
  shared xPON region at 0x1fb60000. Its register layout, PLOAM format and
  activation protocol differ from the older GPON engine at offset 0x4000.
  The EN7580 WAN selector uses 0x0a for XGS-PON. This compatible describes
  only EN7580; it is not a fallback for AN7581 or AN7583.

properties:
  compatible:
    const: airoha,en7580-xpon

  reg:
    maxItems: 1
    description: Shared xPON register region, including the entire 10G MAC.

  reg-names:
    const: mac

  interrupts:
    minItems: 1
    maxItems: 2

  interrupt-names:
    minItems: 1
    items:
      - const: mac
      - const: dying-gasp

  resets:
    maxItems: 1

  reset-names:
    const: mac

  airoha,scu:
    $ref: /schemas/types.yaml#/definitions/phandle
    description: System controller containing the WAN mode selector.

  airoha,pon-mode:
    const: xgspon
    default: xgspon

  ethernet:
    $ref: /schemas/types.yaml#/definitions/phandle
    description: GDM2 Ethernet datapath associated with this MAC.

  phys:
    maxItems: 1
    description: Digital PON PHY used for optical link operation.

  phy-names:
    const: xpon

  sfp:
    $ref: /schemas/types.yaml#/definitions/phandle
    description: Pluggable optical module or cage.

  optical-frontends:
    $ref: /schemas/types.yaml#/definitions/phandle-array
    maxItems: 1

  optical-frontend-names:
    items:
      - const: pon

required:
  - compatible
  - reg
  - reg-names
  - resets
  - reset-names
  - airoha,scu
  - ethernet

dependencies:
  interrupts: [interrupt-names]
  interrupt-names: [interrupts]
  phys: [phy-names]
  phy-names: [phys]
  optical-frontends: [optical-frontend-names]
  optical-frontend-names: [optical-frontends]

additionalProperties: false

examples:
  - |
    #include <dt-bindings/interrupt-controller/mips-gic.h>
    #include <dt-bindings/reset/econet,en7580-scu.h>

    xmac@1fb60000 {
        compatible = "airoha,en7580-xpon";
        reg = <0x1fb60000 0x10000>;
        reg-names = "mac";
        interrupts = <GIC_SHARED 26 IRQ_TYPE_LEVEL_HIGH>,
                     <GIC_SHARED 18 IRQ_TYPE_LEVEL_HIGH>;
        interrupt-names = "mac", "dying-gasp";
        resets = <&scuclk EN7580_XPON_MAC_RST>;
        reset-names = "mac";
        airoha,scu = <&scuclk>;
        airoha,pon-mode = "xgspon";
        ethernet = <&gdm2>;
    };
...
```

## Documentation/devicetree/bindings/net/bluetooth/airoha,ab1536u.yaml
```yaml
# SPDX-License-Identifier: (GPL-2.0-only OR BSD-2-Clause)
%YAML 1.2
---
$id: http://devicetree.org/schemas/net/bluetooth/airoha,ab1536u.yaml#
$schema: http://devicetree.org/meta-schemas/core.yaml#

title: Experimental Airoha AB1536U UART Bluetooth transport

maintainers:
  - Linux Bluetooth <linux-bluetooth@vger.kernel.org>

description: |
  AB1536U firmware can expose an embedded Bluetooth application through
  RACE. External HCI availability depends on the firmware configuration.
  This experimental binding permits testing the UART transport without
  modifying nonvolatile settings. The Gemtek control sequence is specific
  to the Quantum C6500XK and comes from its stock firmware.

properties:
  compatible:
    oneOf:
      - const: airoha,ab1536u
      - items:
          - const: gemtek,c6500xk-ab1536u
          - const: airoha,ab1536u

  max-speed:
    const: 115200

  gemtek,control-gpios:
    minItems: 2
    maxItems: 2
    description: |
      Stock Gemtek control lines, both specified active high. The first
      line is pulsed high and then driven low; the second stays low.
      On the C6500XK these are GPIO26 and GPIO28 respectively. Their
      electrical signal names have not been established. Omit this
      property to test a module already initialized by the bootloader.

required:
  - compatible

allOf:
  - $ref: /schemas/serial/serial-peripheral-props.yaml#
  - if:
      properties:
        compatible:
          const: airoha,ab1536u
    then:
      properties:
        gemtek,control-gpios: false

unevaluatedProperties: false

examples:
  - |
    #include <dt-bindings/gpio/gpio.h>

    serial {
        bluetooth {
            compatible = "gemtek,c6500xk-ab1536u", "airoha,ab1536u";
            max-speed = <115200>;
            gemtek,control-gpios = <&gpio 26 GPIO_ACTIVE_HIGH>,
                                   <&gpio 28 GPIO_ACTIVE_HIGH>;
        };
    };
```

## Documentation/devicetree/bindings/net/econet,en751221-eth.yaml
```yaml
# SPDX-License-Identifier: (GPL-2.0-only OR BSD-2-Clause)
%YAML 1.2
---
$id: http://devicetree.org/schemas/net/econet,en751221-eth.yaml#
$schema: http://devicetree.org/meta-schemas/core.yaml#

title: EcoNet EN751221 Frame Engine Ethernet controller

maintainers:
  - Caleb James DeLisle <cjd@cjdns.fr>

description:
  The EN751221-family frame engine contains two GDM Ethernet ports and two
  QDMA packet engines. The first pair is normally connected to the integrated
  LAN switch and the second pair is normally used by WAN or xPON datapaths.

properties:
  compatible:
    enum:
      - econet,en751221-eth
      - econet,en7528-eth

  reg:
    minItems: 1
    maxItems: 1
    description:
      Frame engine register window. A 0x8000-byte window contains the frame
      engine, both GDM ports and both QDMA engines. A 0x10000-byte window also
      contains the integrated switch registers and allows legacy dumb-switch
      setup when the switch is not owned by another driver.

  interrupts:
    items:
      - description: QDMA0 interrupt
      - description: QDMA1 interrupt

  resets:
    minItems: 1
    maxItems: 6

  reset-names:
    minItems: 1
    items:
      - const: fe
      - const: qdma0
      - const: qdma1
      - const: gsw
      - const: xpon-mac
      - const: xpon-phy

  "#address-cells":
    const: 1

  "#size-cells":
    const: 0

patternProperties:
  "^ethernet@[01]$":
    type: object
    $ref: ethernet-controller.yaml#
    unevaluatedProperties: false

    properties:
      compatible:
        const: econet,eth-mac

      reg:
        minimum: 0
        maximum: 1
        description: GDM port identifier

    required:
      - compatible
      - reg

required:
  - compatible
  - reg
  - interrupts
  - "#address-cells"
  - "#size-cells"

additionalProperties: false

examples:
  - |
    ethernet@1fb50000 {
        compatible = "econet,en751221-eth";
        reg = <0x1fb50000 0x8000>;

        interrupt-parent = <&intc>;
        interrupts = <21>, <22>;

        #address-cells = <1>;
        #size-cells = <0>;

        ethernet@0 {
            compatible = "econet,eth-mac";
            reg = <0>;
            phy-mode = "internal";
        };

        ethernet@1 {
            compatible = "econet,eth-mac";
            reg = <1>;
            phy-mode = "internal";
        };
    };
```

## Documentation/devicetree/bindings/net/econet,en751221-xdsl.yaml
```yaml
# SPDX-License-Identifier: (GPL-2.0-only OR BSD-2-Clause)
%YAML 1.2
---
$id: http://devicetree.org/schemas/net/econet,en751221-xdsl.yaml#
$schema: http://devicetree.org/meta-schemas/core.yaml#

title: EcoNet EN7512 and EN7516 xDSL frontend

maintainers:
  - Matheus Sampaio Queiroga <srherobrine20@gmail.com>

description: |
  The EN751221 and EN751627 SoC families contain a host-controlled DMT engine
  for ADSL and VDSL. EN751221 uses the A60928 analog frontend and EN751627 uses
  A10627. Packet-mode traffic is connected to the frame engine through GDM2.

  This binding describes the DMT control window (including its TPSTC area),
  the PTM-TC MAC and their integration with the Ethernet datapath. The GDMA
  engine is a separate SoC device, even though the line engine uses one of its
  channels. The eFuse calibration bank is also a separate block and must not
  be included in the DMT register resource.

properties:
  compatible:
    enum:
      - econet,en751221-xdsl
      - econet,en751627-xdsl

  reg:
    items:
      - description: DMT control and DSP register window
      - description: PTM-TC MAC registers

  reg-names:
    items:
      - const: dmt
      - const: ptm

  interrupts:
    maxItems: 1

  interrupt-names:
    items:
      - const: dmt

  resets:
    maxItems: 2

  reset-names:
    items:
      - const: dmt
      - const: ptm

  ethernet:
    $ref: /schemas/types.yaml#/definitions/phandle
    description: Phandle to the frame-engine GDM2 netdev used by PTM.

  airoha,scu:
    $ref: /schemas/types.yaml#/definitions/phandle
    description: Phandle to the system-control register block and WAN mux.

  airoha,chip-scu:
    $ref: /schemas/types.yaml#/definitions/phandle
    description: Chip SCU with package selection and AFE trim shadow words.

  airoha,efuse-id:
    $ref: /schemas/types.yaml#/definitions/phandle
    description: |
      Read-only consumer of the syscon covering the single 32-bit
      EFUSE_VERIFY_DATA0 shadow at physical address 0x1fbf8214.
      Used with SCU identity to reject mismatched or non-DSL packages.

required:
  - compatible
  - reg
  - reg-names
  - interrupts
  - interrupt-names
  - resets
  - reset-names
  - ethernet
  - airoha,scu
  - airoha,chip-scu
  - airoha,efuse-id

additionalProperties: false

examples:
  - |
    dsl@1f900000 {
        compatible = "econet,en751221-xdsl";
        reg = <0x1f900000 0x10000>,
              <0x1fb62000 0x200>;
        reg-names = "dmt", "ptm";
        interrupt-parent = <&intc>;
        interrupts = <19>;
        interrupt-names = "dmt";
        resets = <&scuclk 39>, <&scuclk 6>;
        reset-names = "dmt", "ptm";
        ethernet = <&gdm2>;
        airoha,scu = <&scuclk>;
        airoha,chip-scu = <&chip_scu>;
        airoha,efuse-id = <&efuse_id>;
    };
```

## Documentation/devicetree/bindings/net/omci.yaml
```yaml
# SPDX-License-Identifier: (GPL-2.0-only OR BSD-2-Clause)
%YAML 1.2
---
$id: http://devicetree.org/schemas/net/omci.yaml#
$schema: http://devicetree.org/meta-schemas/core.yaml#

title: OMCI ONU identity data

maintainers:
  - Matheus Sampaio Queiroga <srherobrine20@gmail.com>

description: |
  Common ONU identity and registration properties used by OMCI and the
  underlying PON activation engine. Factory data should normally be provided
  through NVMEM cells. Direct properties are intended as board-level fallback
  values.

allOf:
  - $ref: /schemas/nvmem/nvmem-consumer.yaml#

properties:
  nvmem-cells:
    minItems: 1
    maxItems: 5

  nvmem-cell-names:
    minItems: 1
    maxItems: 5
    uniqueItems: true
    items:
      enum:
        - gpon-serial-number
        - gpon-password
        - omci-vendor-id
        - omci-version
        - omci-equipment-id

  omci-serial-number:
    description: |
      GPON serial number. Accepted forms are an eight-byte raw value, four
      vendor characters followed by eight hexadecimal serial digits, or all
      eight bytes encoded as sixteen hexadecimal digits.
    oneOf:
      - $ref: /schemas/types.yaml#/definitions/string
      - $ref: /schemas/types.yaml#/definitions/uint8-array
        minItems: 8
        maxItems: 8

  omci-vendor-id:
    description: |
      Four-byte vendor identifier, as raw bytes, four characters, or eight
      hexadecimal digits. When present it also replaces the vendor prefix of
      the normalized GPON serial number.
    oneOf:
      - $ref: /schemas/types.yaml#/definitions/string
      - $ref: /schemas/types.yaml#/definitions/uint8-array
        minItems: 4
        maxItems: 4

  omci-password:
    description: |
      GPON registration password. Accepted forms are ten raw or ASCII bytes,
      up to ten ASCII characters padded with zeroes, or twenty hexadecimal
      digits. Implementations must not print this value.
    oneOf:
      - $ref: /schemas/types.yaml#/definitions/string
      - $ref: /schemas/types.yaml#/definitions/uint8-array
        minItems: 10
        maxItems: 10

  omci-version:
    description: ONU-G version string, up to fourteen bytes.
    oneOf:
      - $ref: /schemas/types.yaml#/definitions/string
      - $ref: /schemas/types.yaml#/definitions/uint8-array
        minItems: 1
        maxItems: 14

  omci-equipment-id:
    description: ONU2-G equipment identifier, up to twenty bytes.
    oneOf:
      - $ref: /schemas/types.yaml#/definitions/string
      - $ref: /schemas/types.yaml#/definitions/uint8-array
        minItems: 1
        maxItems: 20

additionalProperties: true
...
```

## Documentation/devicetree/bindings/net/optical-frontend.yaml
```yaml
# SPDX-License-Identifier: (GPL-2.0-only OR BSD-2-Clause)
%YAML 1.2
---
$id: http://devicetree.org/schemas/net/optical-frontend.yaml#
$schema: http://devicetree.org/meta-schemas/core.yaml#

title: Common optical frontend provider properties

maintainers:
  - Matheus Sampaio Queiroga <srherobrine20@gmail.com>

description: |
  Common properties for analog optical frontend providers such as laser
  drivers, limiting amplifiers and APD controllers. Provider-specific
  bindings describe the compatible string and transport.

select:
  required:
    - '#optical-frontend-cells'

properties:
  '#optical-frontend-cells':
    const: 0
    description:
      The device exposes one optical frontend provider.

required:
  - '#optical-frontend-cells'

additionalProperties: true
...
```
