## Documentation/devicetree/bindings/cpufreq/airoha,en7581-cpufreq.yaml
```yaml
# SPDX-License-Identifier: (GPL-2.0-only OR BSD-2-Clause)
%YAML 1.2
---
$id: http://devicetree.org/schemas/cpufreq/airoha,en7581-cpufreq.yaml#
$schema: http://devicetree.org/meta-schemas/core.yaml#

title: Airoha EN7581/AN7583 CPUFreq

maintainers:
  - Christian Marangi <ansuelsmth@gmail.com>

description: |
  On newer Airoha SoCs, CPU frequency is scaled indirectly with SMC commands
  to ATF, or directly via CHIP-SCU/MCUCFG PLL registers when ATF SMC is not
  available.

  A virtual clock is exposed. This virtual clock is a get-only clock and
  is used to expose the current global CPU clock. The frequency info comes
  either from the SMC command that reports the clock in MHz or from the
  CPU PLL registers.

  The SMC sets the CPU clock by providing an index, this is modelled as
  performance states in a power domain.

  CPUs can't be individually scaled as the CPU frequency is shared across
  all CPUs and is global.

properties:
  compatible:
    enum:
      - airoha,an7583-cpufreq
      - airoha,en7581-cpufreq

  reg:
    maxItems: 1
    description: Optional MCUCFG register range used for direct PLL switching.

  reg-names:
    const: mcucfg

  airoha,chip-scu:
    $ref: /schemas/types.yaml#/definitions/phandle
    description:
      Optional phandle to the CHIP-SCU node used for direct CPU PLL
      programming when ATF SMC is unavailable.

  '#clock-cells':
    const: 0

  '#power-domain-cells':
    const: 0

  operating-points-v2: true

required:
  - compatible
  - '#clock-cells'
  - '#power-domain-cells'
  - operating-points-v2

dependencies:
  reg: [ reg-names, "airoha,chip-scu" ]
  reg-names: [ reg ]
  airoha,chip-scu: [ reg ]

additionalProperties: false

examples:
  - |
    performance-domain {
        compatible = "airoha,en7581-cpufreq";

        operating-points-v2 = <&cpu_smcc_opp_table>;

        #power-domain-cells = <0>;
        #clock-cells = <0>;
    };
```

## Documentation/devicetree/bindings/net/airoha,an7552-eth.yaml
```yaml
# SPDX-License-Identifier: (GPL-2.0-only OR BSD-2-Clause)
%YAML 1.2
---
$id: http://devicetree.org/schemas/net/airoha,an7552-eth.yaml#
$schema: http://devicetree.org/meta-schemas/core.yaml#

title: Airoha AN7552 and AN7563 Frame Engine Ethernet controller

maintainers:
  - Matheus Sampaio Queiroga <srherobrine20@gmail.com>

description: |
  AN7552 and AN7563 have two QDMA engines and an integrated Gigabit switch.
  The switch CPU port connects to GDM1.

properties:
  compatible:
    oneOf:
      - const: airoha,an7552-eth
      - items:
          - const: airoha,an7563-eth
          - const: airoha,an7552-eth

  reg:
    items:
      - description: Frame engine registers
      - description: QDMA LAN registers
      - description: QDMA WAN registers
      - description: GDMP SRAM configuration

  reg-names:
    items:
      - const: fe
      - const: qdma0
      - const: qdma1
      - const: gdmp

  interrupts:
    items:
      - description: QDMA lan irq0
      - description: QDMA lan irq1
      - description: QDMA lan irq2
      - description: QDMA lan irq3
      - description: QDMA wan irq0
      - description: QDMA wan irq1
      - description: QDMA wan irq2
      - description: QDMA wan irq3
      - description: FE error irq
      - description: PDMA irq

  interrupt-names:
    items:
      - const: lan0
      - const: lan1
      - const: lan2
      - const: lan3
      - const: wan0
      - const: wan1
      - const: wan2
      - const: wan3
      - const: fe-error
      - const: pdma

  resets:
    minItems: 3
    items:
      - description: Frame engine reset
      - description: PDMA reset
      - description: QDMA reset
      - description: GDMP reset
      - description: TDMA reset

  reset-names:
    minItems: 3
    items:
      - const: fe
      - const: pdma
      - const: qdma
      - const: gdmp
      - const: tdma

  memory-region:
    items:
      - description: QDMA LAN forwarding payload memory
      - description: QDMA WAN forwarding payload memory

  memory-region-names:
    items:
      - const: qdma0-buf
      - const: qdma1-buf

  airoha,npu:
    $ref: /schemas/types.yaml#/definitions/phandle
    description:
      Phandle to the node used to configure the NPU module.

  airoha,wed:
    $ref: /schemas/types.yaml#/definitions/phandle-array
    minItems: 1
    maxItems: 2
    description:
      WED instances associated with the PCIe domains used by the wireless
      devices. Entries are ordered by PCI domain number.

  '#address-cells':
    const: 1

  '#size-cells':
    const: 0

patternProperties:
  "^ethernet@[1-4]$":
    type: object
    $ref: ethernet-controller.yaml#
    unevaluatedProperties: false
    description:
      Ethernet GMAC port associated with the MAC controller
    properties:
      compatible:
        const: airoha,eth-mac

      reg:
        minimum: 1
        maximum: 4
        description: GMAC port identifier

    required:
      - compatible
      - reg

required:
  - compatible
  - reg
  - reg-names
  - interrupts
  - interrupt-names
  - resets
  - reset-names
  - '#address-cells'
  - '#size-cells'

additionalProperties: false

examples:
  - |
    #include <dt-bindings/interrupt-controller/arm-gic.h>
    #include <dt-bindings/interrupt-controller/irq.h>

    ethernet@1fb50000 {
      compatible = "airoha,an7552-eth";
      reg = <0x1fb50000 0x2600>,
            <0x1fb54000 0x2000>,
            <0x1fb56000 0x2000>,
            <0x1fbf9000 0x1000>;
      reg-names = "fe", "qdma0", "qdma1", "gdmp";
      resets = <&scuclk 44>,
               <&scuclk 30>,
               <&scuclk 31>,
               <&scuclk 45>,
               <&scuclk 46>;
      reset-names = "fe", "pdma", "qdma", "gdmp", "tdma";
      interrupts = <GIC_SPI 37 IRQ_TYPE_LEVEL_HIGH>,
                   <GIC_SPI 55 IRQ_TYPE_LEVEL_HIGH>,
                   <GIC_SPI 56 IRQ_TYPE_LEVEL_HIGH>,
                   <GIC_SPI 57 IRQ_TYPE_LEVEL_HIGH>,
                   <GIC_SPI 38 IRQ_TYPE_LEVEL_HIGH>,
                   <GIC_SPI 58 IRQ_TYPE_LEVEL_HIGH>,
                   <GIC_SPI 59 IRQ_TYPE_LEVEL_HIGH>,
                   <GIC_SPI 60 IRQ_TYPE_LEVEL_HIGH>,
                   <GIC_SPI 49 IRQ_TYPE_LEVEL_HIGH>,
                   <GIC_SPI 64 IRQ_TYPE_LEVEL_HIGH>;
      interrupt-names = "lan0", "lan1", "lan2", "lan3",
                        "wan0", "wan1", "wan2", "wan3",
                        "fe-error", "pdma";
      memory-region = <&qdma0_buf>, <&qdma1_buf>;
      memory-region-names = "qdma0-buf", "qdma1-buf";
      airoha,npu = <&npu>;
      #address-cells = <1>;
      #size-cells = <0>;

      ethernet@1 {
        compatible = "airoha,eth-mac";
        reg = <1>;
        phy-mode = "internal";
      };
    };
```

## Documentation/devicetree/bindings/net/airoha,en7523-wed.yaml
```yaml
# SPDX-License-Identifier: (GPL-2.0-only OR BSD-2-Clause)
%YAML 1.2
---
$id: http://devicetree.org/schemas/net/airoha,en7523-wed.yaml#
$schema: http://devicetree.org/meta-schemas/core.yaml#

title: Airoha EN7523 WED v1 controller

maintainers:
  - Lorenzo Bianconi <lorenzo@kernel.org>
  - Matheus Sampaio Queiroga <srherobrine20@gmail.com>

description:
  The Wireless Ethernet Dispatch (WED) controller connects a PCIe wireless
  DMA engine to the Ethernet frame engine and offloads the wireless transmit
  datapath. Each WED instance is associated with one PCIe domain and one
  WDMA instance.

properties:
  compatible:
    items:
      - const: airoha,en7523-wed
      - const: syscon

  reg:
    items:
      - description: WED register block
      - description: WDMA register block

  reg-names:
    items:
      - const: wed
      - const: wdma

  interrupts:
    minItems: 1
    items:
      - description: WED interrupt
      - description: WDMA port 0 interrupt
      - description: WDMA port 1 interrupt
      - description: WDMA WOE interrupt

  interrupt-names:
    minItems: 1
    items:
      - const: wed
      - const: wdma-port0
      - const: wdma-port1
      - const: wdma-woe

required:
  - compatible
  - reg
  - reg-names
  - interrupts

additionalProperties: false

examples:
  - |
    #include <dt-bindings/interrupt-controller/arm-gic.h>
    #include <dt-bindings/interrupt-controller/irq.h>

    wed@1fa02000 {
      compatible = "airoha,en7523-wed", "syscon";
      reg = <0x1fa02000 0xb00>,
            <0x1fa06000 0x400>;
      reg-names = "wed", "wdma";
      interrupts = <GIC_SPI 67 IRQ_TYPE_LEVEL_HIGH>;
    };
```

## Documentation/devicetree/bindings/spi/airoha,en7581-snand.yaml
```yaml
# SPDX-License-Identifier: (GPL-2.0-only OR BSD-2-Clause)
%YAML 1.2
---
$id: http://devicetree.org/schemas/spi/airoha,en7581-snand.yaml#
$schema: http://devicetree.org/meta-schemas/core.yaml#

title: SPI flash controller for Airoha and EcoNet SoCs

maintainers:
  - Lorenzo Bianconi <lorenzo@kernel.org>

properties:
  compatible:
    oneOf:
      - enum:
          - airoha,en751627-spi
          - airoha,en7581-snand
          - econet,en751221-spi
      - items:
          - enum:
              - airoha,en7523-snand
          - const: airoha,en7581-snand

  reg:
    minItems: 1
    items:
      - description: spi base address
      - description: nfi2spi base address

  reg-names:
    minItems: 1
    items:
      - const: ctrl
      - const: nfi

  airoha,scu:
    $ref: /schemas/types.yaml#/definitions/phandle
    description:
      Phandle to the SCU syscon containing the SoC boot strap register.

  clocks:
    maxItems: 1

  clock-names:
    items:
      - const: spi

required:
  - compatible
  - reg
  - clocks
  - clock-names

allOf:
  - $ref: spi-controller.yaml#
  - if:
      properties:
        compatible:
          contains:
            const: econet,en751221-spi
    then:
      properties:
        reg:
          maxItems: 1
        reg-names:
          maxItems: 1
        airoha,scu: false
    else:
      properties:
        reg:
          minItems: 2
        reg-names:
          minItems: 2
  - if:
      properties:
        compatible:
          contains:
            const: airoha,en751627-spi
    then:
      properties:
        airoha,scu: false

unevaluatedProperties: false

examples:
  - |
    #include <dt-bindings/clock/en7523-clk.h>

    soc {
      #address-cells = <2>;
      #size-cells = <2>;

      spi@1fa10000 {
        compatible = "airoha,en7581-snand";
        reg = <0x0 0x1fa10000 0x0 0x140>,
              <0x0 0x1fa11000 0x0 0x160>;

        clocks = <&scuclk EN7523_CLK_SPI>;
        clock-names = "spi";

        #address-cells = <1>;
        #size-cells = <0>;

        flash@0 {
          compatible = "spi-nand";
          reg = <0>;
          spi-tx-bus-width = <1>;
          spi-rx-bus-width = <2>;
        };
      };
    };

  - |
    #include <dt-bindings/clock/en7523-clk.h>

    soc {
      #address-cells = <1>;
      #size-cells = <1>;

      spi@1fa10000 {
        compatible = "airoha,en751627-spi";
        reg = <0x1fa10000 0x140>,
              <0x1fa11000 0x600>;
        reg-names = "ctrl", "nfi";

        clocks = <&scuclk EN7523_CLK_SPI>;
        clock-names = "spi";

        #address-cells = <1>;
        #size-cells = <0>;

        flash@0 {
          compatible = "spi-nand";
          reg = <0>;
          spi-tx-bus-width = <1>;
          spi-rx-bus-width = <2>;
        };
      };
    };

  - |
    #include <dt-bindings/clock/econet,en751221-scu.h>

    soc {
      #address-cells = <1>;
      #size-cells = <1>;

      spi@1fa10000 {
        compatible = "econet,en751221-spi";
        reg = <0x1fa10000 0x140>;

        clocks = <&scuclk EN751221_CLK_SPI>;
        clock-names = "spi";

        #address-cells = <1>;
        #size-cells = <0>;

        flash@0 {
          compatible = "spi-nand";
          reg = <0>;
          spi-tx-bus-width = <1>;
          spi-rx-bus-width = <2>;
        };
      };
    };
```

## drivers/net/ethernet/airoha/Kconfig
```kconfig
# SPDX-License-Identifier: GPL-2.0-only
config NET_VENDOR_AIROHA
	bool "Airoha devices"
	depends on ARCH_AIROHA || COMPILE_TEST
	help
	  If you have a Airoha SoC with ethernet, say Y.

if NET_VENDOR_AIROHA

config NET_AIROHA_NPU
	tristate "Airoha NPU support"
	select WANT_DEV_COREDUMP
	select REGMAP_MMIO
	help
	  This driver supports Airoha Network Processor (NPU) available
	  on the Airoha Soc family.

config NET_AIROHA
	tristate "Airoha SoC Gigabit Ethernet support"
	depends on NET_DSA || !NET_DSA
	imply NET_AIROHA_NPU
	select PAGE_POOL
	help
	  This driver supports the gigabit ethernet MACs in the
	  Airoha SoC family.

config NET_AIROHA_FLOW_STATS
	default y
	bool "Airoha flow stats"
	depends on NET_AIROHA && NET_AIROHA_NPU
	help
	  Enable Airoha flowtable statistic counters.

config NET_AIROHA_TSO
	bool "Airoha PDMA TSO v2 offload support"
	depends on NET_AIROHA
	help
	  Enable the PDMA TSO v2 transmit segmentation and scatter-gather
	  engine on Airoha SoCs that provide the dedicated tdma reset line
	  in their device tree. Nonlinear and GSO packets are routed through
	  PDMA while linear packets continue using QDMA.

config NET_AIROHA_SOC_WED
	bool "Airoha SoC Wireless Ethernet Dispatch (WED) support"
	depends on NET_AIROHA
	depends on ARCH_AIROHA || COMPILE_TEST
	select NET_MEDIATEK_WED_COMMON
	select MFD_SYSCON
	select REGMAP_MMIO
	help
	  Enable Wireless Ethernet Dispatch (WED v1) Wi-Fi TX offload on
	  Airoha EN7523 SoCs. Registers the shared mtk_wed_ops hooks so
	  compatible mt76 wireless drivers can offload TX flows via PPE
	  and WDMA.

endif #NET_VENDOR_AIROHA
```
